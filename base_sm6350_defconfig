## base_sm8150_defconfig
```kconfig
# CONFIG_ARM64_VHE is not set
# CONFIG_ECM_IPA is not set
# CONFIG_GSI_REGISTER_VERSION_2 is not set
# CONFIG_INET_XFRM_MODE_BEET is not set
# CONFIG_IPA_DEBUG is not set
# CONFIG_IPA_ETH is not set
# CONFIG_MEMBARRIER is not set
# CONFIG_NETFILTER_XT_MATCH_L2TP is not set
# CONFIG_NETFILTER_XT_MATCH_SCTP is not set
# CONFIG_OKL4_GUEST is not set
# CONFIG_PRINT_QUOTA_WARNING is not set
# CONFIG_SDFAT_FS is not set
# CONFIG_SERIO_SERPORT is not set
# CONFIG_SLUB_DEBUG is not set
# CONFIG_TOUCHSCREEN_INCELL_CLEARPAD is not set
# CONFIG_UNMAP_KERNEL_AT_EL0 is not set
CONFIG_ARCH_SM8150=y
CONFIG_BLK_CGROUP=y
CONFIG_BONDING=y
CONFIG_BRIDGE_EBT_ARPREPLY=y
CONFIG_BRIDGE_EBT_ARP=y
CONFIG_BRIDGE_EBT_DNAT=y
CONFIG_BRIDGE_EBT_IP6=y
CONFIG_BRIDGE_EBT_IP=y
CONFIG_BRIDGE_EBT_SNAT=y
CONFIG_BRIDGE_EBT_T_FILTER=y
CONFIG_BRIDGE_EBT_T_NAT=y
CONFIG_BRIDGE_NETFILTER=y
CONFIG_BTFM_SLIM_WCN3990=y
CONFIG_BTFM_SLIM=y
CONFIG_BUILD_ARM64_DT_OVERLAY=y
CONFIG_CC_STACKPROTECTOR_REGULAR=y
CONFIG_CFG80211_CERTIFICATION_ONUS=y
CONFIG_CFG80211_REG_CELLULAR_HINTS=y
CONFIG_CFQ_GROUP_IOSCHED=y
CONFIG_CLOCK_CPU_OSM=y
CONFIG_COMPAT_VDSO=y
CONFIG_CPU_BOOST=y
CONFIG_CPU_FREQ_DEFAULT_GOV_INTERACTIVE=y
CONFIG_CRYPTO_AES_ARM64_NEON_BLK=y
CONFIG_CRYPTO_ANSI_CPRNG=y
CONFIG_DEFAULT_USE_ENERGY_AWARE=y
CONFIG_DEVFREQ_GOV_CDSPL3=y
CONFIG_DEVFREQ_GOV_PASSIVE=y
CONFIG_DRM_MSM_DP_SOMC_PANEL=y
CONFIG_EDAC_KRYO_ARM64_PANIC_ON_UE=y
CONFIG_EDAC_KRYO_ARM64=y
CONFIG_EDAC=y
CONFIG_ENCRYPTED_KEYS=y
CONFIG_EXT4_FS=y
CONFIG_EXTCON_GPIO=y
CONFIG_EXTCON_SOMC_EXTENSION=y
CONFIG_FORTIFY_SOURCE=y
CONFIG_GSI=y
CONFIG_HDCP_QSEECOM=y
CONFIG_HOTPLUG_SIZE_BITS=29
CONFIG_I2C_QCOM_GENI=y
CONFIG_INPUT_HBTP_INPUT=y
CONFIG_INPUT_QTI_HAPTICS=y
CONFIG_IPA3=y
CONFIG_IPA_WDI_UNIFIED_API=y
CONFIG_IP_SCTP=y
CONFIG_KRYO_PMU_WORKAROUND=y
CONFIG_LCD_CLASS_DEVICE=y
CONFIG_LEDS_CLASS=y
CONFIG_LEDS_TRIGGER_TIMER=y
CONFIG_LOG_CPU_MAX_BUF_SHIFT=17
CONFIG_MFD_I2C_PMIC=y
CONFIG_MMC_CLKGATE=y
CONFIG_MMC_SDHCI_MSM=y
CONFIG_MSM_CAMCC_SM8150=y
CONFIG_MSM_CLK_AOP_QMP=y
CONFIG_MSM_CLK_RPMH=y
CONFIG_MSM_DEBUGCC_SM8150=y
CONFIG_MSM_DISPCC_SM8150=y
CONFIG_MSM_FASTCVPD=y
CONFIG_MSM_GCC_SM8150=y
CONFIG_MSM_GPUCC_SM8150=y
CONFIG_MSM_HSUSB_PHY=y
CONFIG_MSM_NPUCC_SM8150=y
CONFIG_MSM_NPU=y
CONFIG_MSM_PERFORMANCE=y
CONFIG_MSM_QMP=y
CONFIG_MSM_SDE_ROTATOR_EVTLOG_DEBUG=y
CONFIG_MSM_SPCOM=y
CONFIG_MSM_SPSS_UTILS=y
CONFIG_MSM_TZ_LOG=y
CONFIG_MSM_VIDC_GOVERNORS=y
CONFIG_MSM_VIDC_V4L2=y
CONFIG_MSM_VIDEOCC_SM8150=y
CONFIG_NET_ACT_GACT=y
CONFIG_NET_ACT_MIRRED=y
CONFIG_NET_ACT_SKBEDIT=y
CONFIG_NETFILTER_XT_MATCH_QTAGUID=y
CONFIG_NETFILTER_XT_TARGET_HARDIDLETIMER=y
CONFIG_NEW_LEDS=y
CONFIG_NFC_PN553_DEVICES=y
CONFIG_NLS_ASCII=y
CONFIG_NLS_CODEPAGE_437=y
CONFIG_NLS_ISO8859_1=y
CONFIG_NLS_UTF8=y
CONFIG_NVMEM_SPMI_SDAM=y
CONFIG_PAGE_OWNER=y
CONFIG_PANIC_ON_SSR_NOTIF_TIMEOUT=y
CONFIG_PANIC_TIMEOUT=-1
CONFIG_PHYLIB=y
CONFIG_PINCTRL_LPI=y
CONFIG_PINCTRL_SM8150=y
CONFIG_PM_AUTOSLEEP=y
CONFIG_POWER_RESET_XGENE=y
CONFIG_PSTORE_PMSG=y
CONFIG_QCOM_AOP_DDR_MESSAGING=y
CONFIG_QCOM_BUS_CONFIG_RPMH=y
CONFIG_QCOM_CDSP_RM=y
CONFIG_QCOM_COMMAND_DB=y
CONFIG_QCOM_DCC_V2=y
CONFIG_QCOM_EARLY_RANDOM=y
CONFIG_QCOM_FSA4480_I2C=y
CONFIG_QCOM_GENI_SE=y
CONFIG_QCOM_GPI_DMA=y
CONFIG_QCOM_HYP_CORE_CTL=y
CONFIG_QCOM_LLCC_PMU=y
CONFIG_QCOM_LLCC=y
CONFIG_QCOM_QDSS_BRIDGE=y
CONFIG_QCOM_QMI_DFC=y
CONFIG_QCOM_QMI_POWER_COLLAPSE=y
CONFIG_QCOM_QMI_RMNET=y
CONFIG_QCOM_SM8150_LLCC=y
CONFIG_QMP_DEBUGFS_CLIENT=y
CONFIG_QPNP_FG_GEN4=y
CONFIG_QPNP_PBS=y
CONFIG_QPNP_QNOVO5=y
CONFIG_QPNP_SMB5=y
CONFIG_QPNP_SMBFG_NEWGEN_EXTENSION=y
CONFIG_QSEE_IPC_IRQ_BRIDGE=y
CONFIG_QTI_AOP_REG_COOLING_DEVICE=y
CONFIG_QTI_BCL_PMIC5=y
CONFIG_QTI_BCL_SOC_DRIVER=y
CONFIG_QTI_QMI_SENSOR=y
CONFIG_QTI_RPMH_API=y
CONFIG_QTI_THERMAL_LIMITS_DCVS=y
CONFIG_QTI_VIRTUAL_SENSOR=y
CONFIG_RANDOMIZE_BASE=y
CONFIG_RAS=y
CONFIG_REGULATOR_QPNP_AMOLED=y
CONFIG_REGULATOR_REFGEN=y
CONFIG_REGULATOR_RPMH=y
CONFIG_RMNET_CTL=y
CONFIG_RMNET_IPA3=y
CONFIG_RMNET=y
CONFIG_RPMSG_QCOM_GLINK_SPI=y
CONFIG_RPMSG_QCOM_GLINK_SPSS=y
CONFIG_SCHED_AUTOGROUP=y
CONFIG_SCSI_UFSHCD_PLATFORM=y
CONFIG_SCSI_UFSHCD=y
CONFIG_SCSI_UFS_QCOM_ICE=y
CONFIG_SCSI_UFS_QCOM=y
CONFIG_SECURITY_SMACK=y
CONFIG_SEEMP_CORE=y
CONFIG_SENSORS_ET51X=y
CONFIG_SERIAL_MSM_GENI=y
CONFIG_SETUP_SSR_NOTIF_TIMEOUTS=y
CONFIG_SKY2=y
CONFIG_SLAB_FREELIST_HARDENED=y
CONFIG_SLAB_FREELIST_RANDOM=y
CONFIG_SLIMBUS=y
CONFIG_SMB1355_SLAVE_CHARGER=y
CONFIG_SMB1390_CHARGE_PUMP=y
CONFIG_SMSC911X=y
CONFIG_SND_MAX_CARDS=32
CONFIG_SND_SOC_ANALOG_CDC=y
CONFIG_SND_SOC_DIGITAL_CDC=y
CONFIG_SND_SOC_INT_CODEC=y
CONFIG_SND_SOC_MSM_SDW=y
CONFIG_SND_SOC_SDM660_CDC=y
CONFIG_SND_SOC_SDM670=y
CONFIG_SND_SOC_SM8150=y
CONFIG_SND_USB_AUDIO_QMI=y
CONFIG_SOCKEV_NLMCAST=y
CONFIG_SOUNDWIRE_WCD_CTRL=y
CONFIG_SPECTRA_CAMERA=y
CONFIG_SPI_QCOM_GENI=y
CONFIG_SPMI_MSM_PMIC_ARB_DEBUG=y
CONFIG_SSR_SUBSYS_NOTIF_TIMEOUT=20000
CONFIG_SSR_SYSMON_NOTIF_TIMEOUT=20000
CONFIG_STACK_HASH_ORDER_SHIFT=12
CONFIG_SYN_COOKIES=y
CONFIG_TOUCHSCREEN_SAMSUNG_INCELL=y
CONFIG_USB_EHCI_HCD_PLATFORM=y
CONFIG_USB_ISP1760_HOST_ROLE=y
CONFIG_USB_ISP1760=y
CONFIG_USB_LINK_LAYER_TEST=y
CONFIG_USB_OHCI_HCD_PLATFORM=y
CONFIG_USB_OHCI_HCD=y
CONFIG_USB_REDRIVER_NB7VPQ904M=y
CONFIG_USB_SOMC_SLG4R41505=y
CONFIG_USB_VIDEO_CLASS=y
CONFIG_VFAT_FS=y
CONFIG_VIDEO_ADV_DEBUG=y
CONFIG_VIDEO_FIXED_MINOR_RANGES=y
```
