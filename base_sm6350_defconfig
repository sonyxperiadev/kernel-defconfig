## base_sm8450_defconfig
```kconfig
CONFIG_LOCALVERSION="-sodp"
CONFIG_MSM_SYSSTATS=y
CONFIG_RELAY=y
# CONFIG_ARCH_SUNXI is not set
# CONFIG_ARCH_HISI is not set
CONFIG_ARCH_WAIPIO=y
CONFIG_ARM_QCOM_CPUFREQ_HW=y
CONFIG_GH_ARM64_DRV=y
CONFIG_CRYPTO_AES_ARM64=y
# CONFIG_MODULE_SIG_ALL is not set
CONFIG_CMA_AREAS=32
CONFIG_ZSMALLOC=y
CONFIG_SYN_COOKIES=y
CONFIG_QRTR=y
CONFIG_QRTR_SMD=y
CONFIG_QRTR_MHI=y
CONFIG_CFG80211=y
CONFIG_PCI_MSM=y
CONFIG_FW_LOADER_USER_HELPER_FALLBACK=y
CONFIG_MHI_BUS=y
CONFIG_MHI_BUS_DEBUG=y
CONFIG_MHI_BUS_PCI_GENERIC=y
CONFIG_MHI_BUS_MISC=y
CONFIG_MHI_NETDEV=y
CONFIG_MHI_UCI=y
CONFIG_MHI_DTR=y
CONFIG_QTI_SCMI_PMU_PROTOCOL=y
CONFIG_QTI_SCMI_C1DCVS_PROTOCOL=y
CONFIG_QTI_SCMI_MEMLAT_PROTOCOL=y
CONFIG_QTI_SCMI_CPUFREQ_STATS_PROTOCOL=y
CONFIG_QTI_SCMI_PLH_PROTOCOL=y
CONFIG_ZRAM=y
CONFIG_INPUT_BU520X1NVX=y
CONFIG_HAPTICS_CS40L2X=y
CONFIG_SCSI_UFS_QCOM=y
CONFIG_SCSI_UFS_CRYPTO_QTI=y
CONFIG_TOUCHSCREEN_SEC_TS_INCELL=y
CONFIG_INPUT_PM8941_PWRKEY=y
CONFIG_INPUT_QPNP_POWER_ON=y
CONFIG_SERIAL_MSM_GENI=y
CONFIG_HVC_GUNYAH=y
CONFIG_MSM_ADSPRPC=y
CONFIG_I2C_MSM_GENI=y
CONFIG_SPMI_MSM_PMIC_ARB_DEBUG=y
CONFIG_PINCTRL_WAIPIO=y
CONFIG_PINCTRL_QCOM_SPMI_PMIC=y
CONFIG_PINCTRL_SOMC=y
CONFIG_PINCTRL_SOMC_PMIC=y
CONFIG_POWER_RESET_QCOM_DOWNLOAD_MODE=y
CONFIG_POWER_RESET_QCOM_DOWNLOAD_MODE_DEFAULT=y
CONFIG_POWER_RESET_QCOM_PON=y
CONFIG_POWER_RESET_QCOM_REBOOT_REASON=y
CONFIG_QTI_BATTERY_CHARGER=y
CONFIG_QCOM_TSENS=y
CONFIG_QCOM_SPMI_ADC_TM5=y
CONFIG_QCOM_SPMI_TEMP_ALARM=y
CONFIG_QTI_CPU_PAUSE_COOLING_DEVICE=y
CONFIG_QTI_BCL_PMIC5=y
CONFIG_QTI_BCL_SOC_DRIVER=y
CONFIG_QTI_CPU_HOTPLUG_COOLING_DEVICE=y
CONFIG_QTI_CPU_VOLTAGE_COOLING_DEVICE=y
CONFIG_QTI_DDR_COOLING_DEVICE=y
CONFIG_QTI_THERMAL_LIMITS_DCVS=y
CONFIG_QTI_POLICY_ENGINE_SENSOR=y
CONFIG_QTI_QMI_COOLING_DEVICE=y
CONFIG_QTI_QMI_SENSOR_V2=y
CONFIG_QTI_CPUFREQ_CDEV=y
CONFIG_QTI_DEVFREQ_CDEV=y
CONFIG_QTI_USERSPACE_CDEV=y
CONFIG_QTI_SDPM_CLOCK_MONITOR=y
CONFIG_REGULATOR_COOLING_DEVICE=y
CONFIG_QTI_QMI_SENSOR=y
CONFIG_QTI_THERMAL_MINIDUMP=y
CONFIG_MFD_I2C_PMIC=y
CONFIG_MFD_SPMI_PMIC=y
CONFIG_REGULATOR_DEBUG_CONTROL=y
CONFIG_REGULATOR_QTI_FIXED_VOLTAGE=y
CONFIG_REGULATOR_PROXY_CONSUMER=y
CONFIG_REGULATOR_QPNP_AMOLED=y
CONFIG_REGULATOR_RPMH=y
CONFIG_MSM_GLOBAL_SYNX=y
CONFIG_MSM_GLOBAL_IPCLITE=y
CONFIG_FB_EARLY=y
CONFIG_SND_SOC_CS35L41_I2C=y
CONFIG_USB_XHCI_PCI_RENESAS=y
CONFIG_USB_DWC3_MSM=y
CONFIG_USB_MSM_SSPHY_QMP=y
CONFIG_MSM_HSUSB_PHY=y
CONFIG_USB_CONFIGFS_RNDIS=y
CONFIG_USB_CONFIGFS_F_CDEV=y
CONFIG_USB_CONFIGFS_F_CCID=y
CONFIG_USB_CONFIGFS_F_QDSS=y
CONFIG_USB_CONFIGFS_F_GSI=y
CONFIG_USB_CONFIGFS_F_DIAG=y
CONFIG_UCSI_QTI_GLINK=y
CONFIG_MMC_SDHCI_MSM=y
CONFIG_LEDS_QTI_TRI_LED=y
CONFIG_EDAC_KRYO_ARM64=y
CONFIG_EDAC_KRYO_ARM64_PANIC_ON_UE=y
CONFIG_EDAC_QCOM=y
CONFIG_EDAC_QCOM_LLCC_PANIC_ON_UE=y
CONFIG_QCOM_BAM_DMA=y
CONFIG_MSM_GPI_DMA=y
CONFIG_QCOM_DMABUF_HEAPS=y
CONFIG_QCOM_DMABUF_HEAPS_SYSTEM=y
CONFIG_QCOM_DMABUF_HEAPS_PAGE_POOL_REFILL=y
CONFIG_QCOM_DMABUF_HEAPS_SYSTEM_SECURE=y
CONFIG_QCOM_DMABUF_HEAPS_CMA=y
CONFIG_QCOM_DMABUF_HEAPS_CARVEOUT=y
CONFIG_UIO_MSM_SHAREDMEM=y
CONFIG_VIRT_DRIVERS=y
CONFIG_GUNYAH_DRIVERS=y
CONFIG_GH_CTRL=y
CONFIG_GH_DBL=y
CONFIG_GH_MSGQ=y
CONFIG_GH_RM_DRV=y
CONFIG_GH_IRQ_LEND=y
CONFIG_GH_MEM_NOTIFIER=y
CONFIG_QCA_CLD_WLAN=y
CONFIG_IPA3=y
CONFIG_EP_PCIE=y
CONFIG_MSM_MHI_DEV=y
CONFIG_MSM_MHI_NET_DEV=y
CONFIG_COMMON_CLK_QCOM=y
CONFIG_QCOM_CLK_RPMH=y
CONFIG_QCOM_GDSC_REGULATOR=y
CONFIG_MSM_VIDEOCC_WAIPIO=y
CONFIG_MSM_GPUCC_WAIPIO=y
CONFIG_MSM_DISPCC_WAIPIO=y
CONFIG_MSM_DEBUGCC_WAIPIO=y
CONFIG_HWSPINLOCK_QCOM=y
CONFIG_SUN4I_TIMER=y
CONFIG_QCOM_IPCC=y
CONFIG_IOMMU_IO_PGTABLE_FAST=y
CONFIG_QTI_IOMMU_SUPPORT=y
CONFIG_ARM_SMMU=y
CONFIG_ARM_SMMU_CONTEXT_FAULT_RETRY=y
CONFIG_ARM_SMMU_TESTBUS=y
CONFIG_QCOM_LAZY_MAPPING=y
CONFIG_QCOM_IOMMU_UTIL=y
CONFIG_QCOM_IOMMU_DEBUG=y
CONFIG_QCOM_Q6V5_PAS=y
CONFIG_QCOM_SPSS=y
CONFIG_QCOM_SPSS_AC_RESTRICTION=y
CONFIG_QCOM_SYSMON=y
CONFIG_RPMSG_QCOM_GLINK_RPM=y
CONFIG_RPMSG_QCOM_GLINK_SMEM=y
CONFIG_RPMSG_QCOM_GLINK_SPSS=y
CONFIG_RPMSG_QCOM_SMD=y
CONFIG_SPS=y
CONFIG_SPS_SUPPORT_NDP_BAM=y
CONFIG_QCOM_AOSS_QMP=y
CONFIG_QCOM_COMMAND_DB=y
CONFIG_QCOM_GSBI=y
CONFIG_QCOM_MSM_IPCC=y
CONFIG_QCOM_RIMPS=y
CONFIG_QCOM_LLCC=y
CONFIG_QCOM_LLCC_PERFMON=y
CONFIG_MEM_SHARE_QMI_SERVICE=y
CONFIG_QCOM_QFPROM_SYS=y
CONFIG_MSM_CORE_HANG_DETECT=y
CONFIG_QCOM_RPMH=y
CONFIG_QCOM_RUN_QUEUE_STATS=y
CONFIG_QCOM_SMEM=y
CONFIG_QCOM_SMP2P=y
CONFIG_QCOM_MICRODUMP=y
CONFIG_QCOM_SMP2P_SLEEPSTATE=y
CONFIG_SENSORS_SSC=y
CONFIG_QCOM_GLINK=y
CONFIG_QCOM_GLINK_PKT=y
CONFIG_QTI_PMIC_GLINK=y
CONFIG_QTI_BATTERY_GLINK_DEBUG=y
CONFIG_QTI_CHARGER_ULOG_GLINK=y
CONFIG_QTI_ALTMODE_GLINK=y
CONFIG_QTI_PMIC_GLINK_DEBUG=y
CONFIG_QCOM_SECURE_BUFFER=y
CONFIG_QCOM_MEM_HOOKS=y
CONFIG_QCOM_BALANCE_ANON_FILE_RECLAIM=y
CONFIG_MSM_CDSP_LOADER=y
CONFIG_QTI_SYS_PM_VX=y
CONFIG_QCOM_SOCINFO=y
CONFIG_QCOM_PMU_LIB=y
CONFIG_QCOM_DCVS_FP=y
CONFIG_QCOM_DCVS=y
CONFIG_QCOM_MEMLAT=y
CONFIG_QCOM_BWMON=y
CONFIG_QTI_PMU_SCMI_CLIENT=y
CONFIG_QTI_C1DCVS_SCMI_CLIENT=y
CONFIG_QCOM_WDT_CORE=y
CONFIG_QCOM_SOC_WATCHDOG=y
CONFIG_QCOM_LOGBUF_VENDOR_HOOKS=y
CONFIG_MSM_SPSS_UTILS=y
CONFIG_QCOM_SUBSYSTEM_SLEEP_STATS=y
CONFIG_QCOM_CDSP_RM=y
CONFIG_QCOM_SYSMON_SUBSYSTEM_STATS=y
CONFIG_QCOM_EUD=y
CONFIG_QPNP_PBS=y
CONFIG_QTI_PMIC_PON_LOG=y
CONFIG_MSM_BOOT_STATS=y
CONFIG_USB_BAM=y
CONFIG_QCOM_RAMDUMP=y
CONFIG_QCOM_CPU_VENDOR_HOOKS=y
CONFIG_QCOM_PANEL_EVENT_NOTIFIER=y
CONFIG_QTI_CRYPTO_COMMON=y
CONFIG_QTI_HW_KEY_MANAGER=y
CONFIG_QCOM_GUESTVM=y
CONFIG_GH_TLMM_VM_MEM_ACCESS=y
CONFIG_MSM_PERFORMANCE=y
CONFIG_QCOM_MINIDUMP=y
CONFIG_QCOM_DYN_MINIDUMP_STACK=y
CONFIG_QCOM_MINIDUMP_FTRACE=y
CONFIG_QCOM_MINIDUMP_PANIC_DUMP=y
CONFIG_QCOM_MINIDUMP_PSTORE=y
CONFIG_MSM_QBT_HANDLER=y
CONFIG_QCOM_MEM_BUF=y
CONFIG_QCOM_MEM_BUF_GH=y
CONFIG_QCOM_MEM_BUF_MSGQ=y
CONFIG_MSM_TMECOM_QMP=y
CONFIG_QCOM_SPMI_ADC5=y
CONFIG_PWM_QTI_LPG=y
CONFIG_QCOM_PDC=y
CONFIG_PHY_QCOM_UFS=y
CONFIG_QCOM_LLCC_PMU=y
CONFIG_QCOM_QFPROM=y
CONFIG_NVMEM_SPMI_SDAM=y
CONFIG_SLIMBUS=y
CONFIG_SLIM_QCOM_NGD_CTRL=y
CONFIG_INTERCONNECT_QCOM=y
CONFIG_INTERCONNECT_QCOM_WAIPIO=y
CONFIG_INTERCONNECT_QCOM_DEBUG=y
CONFIG_TMPFS_POSIX_ACL=y
CONFIG_ECRYPT_FS=y
CONFIG_CRYPTO_DEV_QCEDEV=y
CONFIG_SYSTEM_TRUSTED_KEYS="verity.x509.pem"
# CONFIG_PRINTK_CALLER is not set
CONFIG_DYNAMIC_DEBUG=y
CONFIG_PANIC_TIMEOUT=5
CONFIG_IPC_LOGGING=y
CONFIG_IPC_LOG_MINIDUMP_BUFFERS=16
CONFIG_SCHED_WALT=y
```

## base_sm8550_defconfig
```kconfig
CONFIG_LOCALVERSION="-sodp"
CONFIG_MSM_SYSSTATS=y
# CONFIG_ARCH_SUNXI is not set
# CONFIG_ARCH_HISI is not set
CONFIG_ARCH_KALAMA=y
CONFIG_CPU_IDLE_GOV_QCOM_LPM=y
CONFIG_ARM_QCOM_CPUFREQ_HW=y
CONFIG_ARM_QCOM_CPUFREQ_HW_DEBUG=y
CONFIG_GH_ARM64_DRV=y
# CONFIG_MODULE_SIG_ALL is not set
CONFIG_ZSMALLOC=y
CONFIG_QRTR=y
CONFIG_QRTR_SMD=y
CONFIG_QRTR_MHI=y
CONFIG_QRTR_GUNYAH=y
CONFIG_CFG80211=y
CONFIG_NL80211_TESTMODE=y
# CONFIG_CFG80211_DEFAULT_PS is not set
# CONFIG_CFG80211_CRDA_SUPPORT is not set
CONFIG_MAC80211=y
# CONFIG_MAC80211_RC_MINSTREL is not set
CONFIG_PCI_MSM=y
CONFIG_REGMAP_QTI_DEBUGFS=y
CONFIG_MHI_BUS=y
CONFIG_MHI_BUS_MISC=y
CONFIG_MHI_NETDEV=y
CONFIG_MHI_UCI=y
CONFIG_MHI_DTR=y
CONFIG_MHI_SATELLITE=y
CONFIG_MHI_QCOM=y
CONFIG_QTI_SCMI_PMU_PROTOCOL=y
CONFIG_QTI_SCMI_C1DCVS_PROTOCOL=y
CONFIG_QTI_SCMI_MEMLAT_PROTOCOL=y
CONFIG_QTI_SCMI_CPUFREQ_STATS_PROTOCOL=y
CONFIG_QTI_SCMI_PLH_PROTOCOL=y
CONFIG_ZRAM=y
CONFIG_BLK_DEV_NVME=y
CONFIG_QSEECOM_PROXY=y
CONFIG_CHR_DEV_SG=y
CONFIG_SCSI_UFS_QCOM=y
CONFIG_SCSI_UFS_CRYPTO_QTI=y
CONFIG_INPUT_PM8941_PWRKEY=y
CONFIG_SERIAL_MSM_GENI=y
CONFIG_HVC_GUNYAH=y
CONFIG_MSM_ADSPRPC=y
CONFIG_MSM_RDBG=y
CONFIG_I2C_MSM_GENI=y
CONFIG_I3C_MASTER_MSM_GENI=y
CONFIG_SPI_MSM_GENI=y
CONFIG_SPMI_MSM_PMIC_ARB=y
CONFIG_SPMI_MSM_PMIC_ARB_DEBUG=y
CONFIG_PINCTRL_KALAMA=y
CONFIG_PINCTRL_CROW=y
CONFIG_PINCTRL_QCOM_SPMI_PMIC=y
CONFIG_PINCTRL_SOMC=y
CONFIG_PINCTRL_SOMC_PMIC=y
CONFIG_POWER_RESET_QCOM_DOWNLOAD_MODE=y
CONFIG_POWER_RESET_QCOM_DOWNLOAD_MODE_DEFAULT=y
CONFIG_POWER_RESET_QCOM_PON=y
CONFIG_POWER_RESET_QCOM_REBOOT_REASON=y
CONFIG_QTI_BATTERY_CHARGER=y
CONFIG_QCOM_TSENS=y
CONFIG_QCOM_SPMI_TEMP_ALARM=y
CONFIG_QTI_CPU_PAUSE_COOLING_DEVICE=y
CONFIG_QTI_BCL_PMIC5=y
CONFIG_QTI_BCL_SOC_DRIVER=y
CONFIG_QTI_CPU_HOTPLUG_COOLING_DEVICE=y
CONFIG_QTI_CPU_VOLTAGE_COOLING_DEVICE=y
CONFIG_QTI_DDR_COOLING_DEVICE=y
CONFIG_MAX31760_FAN_CONTROLLER=y
CONFIG_QTI_THERMAL_LIMITS_DCVS=y
CONFIG_QTI_POLICY_ENGINE_SENSOR=y
CONFIG_QTI_QMI_COOLING_DEVICE=y
CONFIG_QTI_QMI_SENSOR_V2=y
CONFIG_QTI_CPUFREQ_CDEV=y
CONFIG_QTI_DEVFREQ_CDEV=y
CONFIG_QTI_USERSPACE_CDEV=y
CONFIG_QTI_SDPM_CLOCK_MONITOR=y
CONFIG_QTI_THERMAL_MINIDUMP=y
CONFIG_MFD_SPMI_PMIC=y
CONFIG_REGULATOR_DEBUG_CONTROL=y
CONFIG_REGULATOR_QTI_FIXED_VOLTAGE=y
CONFIG_REGULATOR_PROXY_CONSUMER=y
CONFIG_REGULATOR_QPNP_AMOLED=y
CONFIG_REGULATOR_RPMH=y
CONFIG_REGULATOR_STUB=y
CONFIG_REGULATOR_QTI_OCP_NOTIFIER=y
CONFIG_MSM_GLOBAL_SYNX=y
CONFIG_MSM_GLOBAL_SYNX=y
CONFIG_DRM_LT9611UXC=y
CONFIG_SND_USB_AUDIO_QMI=y
CONFIG_USB_MON=y
CONFIG_USB_DWC3_MSM=y
CONFIG_USB_EHSET_TEST_FIXTURE=y
CONFIG_NOP_USB_XCEIV=y
CONFIG_USB_QCOM_EMU_PHY=y
CONFIG_USB_MSM_SSPHY_QMP=y
CONFIG_USB_MSM_EUSB2_PHY=y
CONFIG_USB_M31_MSM_EUSB2_PHY=y
CONFIG_USB_F_FS_IPC_LOGGING=y
CONFIG_USB_CONFIGFS_F_CDEV=y
CONFIG_USB_CONFIGFS_F_CCID=y
CONFIG_USB_CONFIGFS_F_QDSS=y
CONFIG_USB_CONFIGFS_F_GSI=y
CONFIG_USB_CONFIGFS_F_DIAG=y
CONFIG_UCSI_QTI_GLINK=y
CONFIG_USB_REPEATER=y
CONFIG_QTI_PMIC_EUSB2_REPEATER=y
CONFIG_I2C_EUSB2_REPEATER=y
CONFIG_USB_REDRIVER=y
CONFIG_MMC_SDHCI_MSM=y
CONFIG_LEDS_QTI_FLASH=y
CONFIG_LEDS_QTI_TRI_LED=y
CONFIG_LEDS_QPNP_VIBRATOR_LDO=y
CONFIG_EDAC_QCOM=y
CONFIG_EDAC_QCOM_LLCC_PANIC_ON_UE=y
CONFIG_RTC_DRV_PM8XXX=y
CONFIG_QCOM_BAM_DMA=y
CONFIG_MSM_GPI_DMA=y
CONFIG_QCOM_DMABUF_HEAPS=y
CONFIG_QCOM_DMABUF_HEAPS_SYSTEM=y
CONFIG_QCOM_DMABUF_HEAPS_PAGE_POOL_REFILL=y
CONFIG_QCOM_DMABUF_HEAPS_SYSTEM_SECURE=y
CONFIG_QCOM_DMABUF_HEAPS_CMA=y
CONFIG_QCOM_DMABUF_HEAPS_CARVEOUT=y
CONFIG_QCOM_DMABUF_HEAPS_BITSTREAM_CONTIG=y
CONFIG_UIO_MSM_SHAREDMEM=y
CONFIG_VIRT_DRIVERS=y
CONFIG_GUNYAH=y
CONFIG_GH_SECURE_VM_LOADER=y
CONFIG_GH_PROXY_SCHED=y
CONFIG_GUNYAH_DRIVERS=y
CONFIG_GH_VIRT_WATCHDOG=y
CONFIG_GH_CTRL=y
CONFIG_GH_DBL=y
CONFIG_GH_MSGQ=y
CONFIG_GH_RM_DRV=y
CONFIG_GH_IRQ_LEND=y
CONFIG_GH_MEM_NOTIFIER=y
CONFIG_IPA3=y
CONFIG_EP_PCIE=y
CONFIG_MSM_MHI_DEV=y
CONFIG_MSM_MHI_NET_DEV=y
CONFIG_COMMON_CLK_QCOM=y
CONFIG_QCOM_CLK_RPMH=y
CONFIG_QCOM_GDSC_REGULATOR=y
CONFIG_SM_GCC_KALAMA=y
CONFIG_SM_VIDEOCC_KALAMA=y
CONFIG_SM_CAMCC_KALAMA=y
CONFIG_SM_DISPCC_KALAMA=y
CONFIG_SM_DEBUGCC_KALAMA=y
CONFIG_SM_GPUCC_KALAMA=y
CONFIG_SM_TCSRCC_KALAMA=y
CONFIG_SM_GCC_CROW=y
CONFIG_SM_CAMCC_CROW=y
CONFIG_SM_VIDEOCC_CROW=y
CONFIG_SM_GPUCC_CROW=y
CONFIG_SM_DISPCC_CROW=y
CONFIG_SM_DEBUGCC_CROW=y
CONFIG_HWSPINLOCK_QCOM=y
CONFIG_IOMMU_IO_PGTABLE_FAST=y
CONFIG_QTI_IOMMU_SUPPORT=y
CONFIG_ARM_SMMU=y
CONFIG_QCOM_LAZY_MAPPING=y
CONFIG_QCOM_IOMMU_UTIL=y
CONFIG_QCOM_IOMMU_DEBUG=y
CONFIG_QCOM_Q6V5_PAS=y
CONFIG_QCOM_SPSS=y
CONFIG_QCOM_ESOC=y
CONFIG_QCOM_ESOC_DEV=y
CONFIG_QCOM_ESOC_CLIENT=y
CONFIG_QCOM_ESOC_DEBUG=y
CONFIG_QCOM_ESOC_MDM_4X=y
CONFIG_QCOM_ESOC_MDM_DRV=y
CONFIG_QCOM_SYSMON=y
CONFIG_QCOM_PANIC_ON_NOTIF_TIMEOUT=y
CONFIG_RPROC_SYSMON_NOTIF_TIMEOUT=20000
CONFIG_RPROC_SSR_NOTIF_TIMEOUT=20000
CONFIG_RPMSG_QCOM_GLINK_SMEM=y
CONFIG_RPMSG_QCOM_GLINK_SPSS=y
CONFIG_RPMSG_QCOM_SMD=y
CONFIG_SPS=y
CONFIG_SPS_SUPPORT_NDP_BAM=y
CONFIG_QCOM_AOSS_QMP=y
CONFIG_QCOM_COMMAND_DB=y
CONFIG_QCOM_QDSS_BRIDGE=y
CONFIG_QCOM_CPUSS_SLEEP_STATS=y
CONFIG_SHOW_SUSPEND_EPOCH=y
CONFIG_QCOM_MSM_IPCC=y
CONFIG_QCOM_RIMPS=y
CONFIG_QCOM_LLCC=y
CONFIG_QCOM_LLCC_PERFMON=y
CONFIG_QCOM_PANIC_ON_PDR_NOTIF_TIMEOUT=y
CONFIG_PDR_INDICATION_NOTIF_TIMEOUT=9000
CONFIG_MEM_SHARE_QMI_SERVICE=y
CONFIG_QCOM_QFPROM_SYS=y
CONFIG_MSM_CORE_HANG_DETECT=y
CONFIG_QCOM_RPMH=y
CONFIG_QCOM_RUN_QUEUE_STATS=y
CONFIG_QCOM_SMEM=y
CONFIG_QCOM_MEMORY_DUMP_V2=y
CONFIG_QCOM_SMP2P=y
CONFIG_QCOM_MICRODUMP=y
CONFIG_QCOM_SMP2P_SLEEPSTATE=y
CONFIG_QSEE_IPC_IRQ_BRIDGE=y
CONFIG_QCOM_GLINK=y
CONFIG_QCOM_GLINK_PKT=y
CONFIG_QTI_PMIC_GLINK=y
CONFIG_QTI_BATTERY_GLINK_DEBUG=y
CONFIG_QTI_CHARGER_ULOG_GLINK=y
CONFIG_QTI_ALTMODE_GLINK=y
CONFIG_QTI_PMIC_GLINK_DEBUG=y
CONFIG_QCOM_SECURE_BUFFER=y
CONFIG_QCOM_MEM_HOOKS=y
CONFIG_QCOM_BALANCE_ANON_FILE_RECLAIM=y
CONFIG_MSM_CDSP_LOADER=y
CONFIG_QTI_SYS_PM_VX=y
CONFIG_QCOM_SOCINFO=y
CONFIG_QCOM_PMU_LIB=y
CONFIG_QCOM_DCVS_FP=y
CONFIG_QCOM_DCVS=y
CONFIG_QCOM_MEMLAT=y
CONFIG_QCOM_BWMON=y
CONFIG_QTI_HW_MEMLAT_SCMI_CLIENT=y
CONFIG_QTI_PMU_SCMI_CLIENT=y
CONFIG_QTI_C1DCVS_SCMI_CLIENT=y
CONFIG_QTI_CPUFREQ_STATS_SCMI_CLIENT=y
CONFIG_QTI_RIMPS_LOG=y
CONFIG_QTI_PLH_SCMI_CLIENT=y
CONFIG_QCOM_SOC_SLEEP_STATS=y
CONFIG_QCOM_ADSP_SLEEPMON=y
CONFIG_QCOM_WDT_CORE=y
CONFIG_QCOM_IRQ_STAT=y
CONFIG_QCOM_LOGBUF_VENDOR_HOOKS=y
CONFIG_QCOM_FORCE_WDOG_BITE_ON_PANIC=y
CONFIG_MSM_SPCOM=y
CONFIG_MSM_SPSS_UTILS=y
CONFIG_QCOM_DCC_V2=y
CONFIG_QCOM_SUBSYSTEM_SLEEP_STATS=y
CONFIG_QCOM_CDSP_RM=y
CONFIG_QCOM_SYSMON_SUBSYSTEM_STATS=y
CONFIG_QCOM_EUD=y
CONFIG_QTI_PMIC_PON_LOG=y
CONFIG_MSM_BOOT_STATS=y
CONFIG_USB_BAM=y
CONFIG_QCOM_RAMDUMP=y
CONFIG_QCOM_CPU_VENDOR_HOOKS=y
CONFIG_QCOM_PANEL_EVENT_NOTIFIER=y
CONFIG_QTI_CRYPTO_COMMON=y
CONFIG_QTI_HW_KEY_MANAGER=y
CONFIG_QCOM_HUNG_TASK_ENH=y
CONFIG_QCOM_FSA4480_I2C=y
CONFIG_GH_TLMM_VM_MEM_ACCESS=y
CONFIG_MSM_PERFORMANCE=y
CONFIG_QCOM_WCD_USBSS_I2C=y
CONFIG_QCOM_MINIDUMP=y
CONFIG_QCOM_VA_MINIDUMP=y
CONFIG_QCOM_MINIDUMP_FTRACE=y
CONFIG_QCOM_MINIDUMP_PANIC_DUMP=y
CONFIG_QCOM_MINIDUMP_PANIC_CPU_CONTEXT=y
CONFIG_QCOM_MINIDUMP_PSTORE=y
CONFIG_MSM_QBT_HANDLER=y
CONFIG_QCOM_VM_DMESG_DUMPER=y
CONFIG_QCOM_DEBUG_SYMBOL=y
CONFIG_QCOM_MEM_BUF=y
CONFIG_QCOM_MEM_BUF_GH=y
CONFIG_QCOM_MEM_BUF_MSGQ=y
CONFIG_MSM_TMECOM_QMP=y
CONFIG_IIO_BUFFER_CB=y
CONFIG_QCOM_SPMI_ADC5_GEN3=y
CONFIG_PWM_QTI_LPG=y
CONFIG_QCOM_SHOW_RESUME_IRQ=y
CONFIG_QCOM_PDC=y
CONFIG_PHY_QCOM_UFS=y
CONFIG_PHY_QCOM_UFS_QRBTC_SDM845=y
CONFIG_QCOM_LLCC_PMU=y
CONFIG_QCOM_QFPROM=y
CONFIG_NVMEM_SPMI_SDAM=y
CONFIG_STM_PROTO_BASIC=y
CONFIG_STM_PROTO_OST=y
CONFIG_STM_SOURCE_CONSOLE=y
CONFIG_STM_SOURCE_FTRACE=y
CONFIG_SLIMBUS=y
CONFIG_SLIM_QCOM_NGD_CTRL=y
CONFIG_INTERCONNECT_TEST=y
CONFIG_INTERCONNECT_QCOM=y
CONFIG_INTERCONNECT_QCOM_KALAMA=y
CONFIG_INTERCONNECT_QCOM_CROW=y
CONFIG_INTERCONNECT_QCOM_DEBUG=y
CONFIG_IPC_LOGGING=y
CONFIG_IPC_LOG_MINIDUMP_BUFFERS=16
CONFIG_CORESIGHT=y
CONFIG_CORESIGHT_LINK_AND_SINK_TMC=y
CONFIG_CORESIGHT_STM=y
CONFIG_CORESIGHT_CTI=y
CONFIG_CORESIGHT_TPDA=y
CONFIG_CORESIGHT_TPDM=y
CONFIG_CORESIGHT_DUMMY=y
CONFIG_CORESIGHT_REMOTE_ETM=y
CONFIG_CORESIGHT_TGU=y
CONFIG_CORESIGHT_HWEVENT=y
CONFIG_KUNIT=y
CONFIG_KUNIT_DEBUGFS=y
CONFIG_SCHED_WALT=y
```

## base_tama_akari_defconfig
```kconfig
CONFIG_MACH_SONY_AKARI=y
CONFIG_INPUT_QTI_HAPTICS=y
CONFIG_TOUCHSCREEN_CLEARPAD_CORE=y
CONFIG_TOUCHSCREEN_CLEARPAD_I2C=y
CONFIG_TOUCHSCREEN_CLEARPAD_RMI_DEV=y
CONFIG_TOUCHSCREEN_SYNAPTICS_TCM=y
CONFIG_TOUCHSCREEN_SYNAPTICS_TCM_CORE=y
CONFIG_TOUCHSCREEN_SYNAPTICS_TCM_TOUCH=y
CONFIG_TOUCHSCREEN_SYNAPTICS_TCM_DEVICE=y
CONFIG_TOUCHSCREEN_SYNAPTICS_TCM_REFLASH=y
CONFIG_IDTP9221=y
```

## base_tama_akatsuki_defconfig
```kconfig
CONFIG_MACH_SONY_AKATSUKI=y
CONFIG_IDTP9221=y
CONFIG_TOUCHSCREEN_ATMEL_MXT640U=y
```

## base_tama_apollo_defconfig
```kconfig
CONFIG_MACH_SONY_APOLLO=y
CONFIG_INPUT_BU520X1NVX=y
CONFIG_LDO_VIBRATOR=y
CONFIG_TOUCHSCREEN_CLEARPAD_CORE=y
CONFIG_TOUCHSCREEN_CLEARPAD_I2C=y
CONFIG_TOUCHSCREEN_CLEARPAD_RMI_DEV=y
CONFIG_TOUCHSCREEN_SYNAPTICS_TCM_TAMA=y
CONFIG_TOUCHSCREEN_SYNAPTICS_TCM_TAMA_I2C=y
CONFIG_TOUCHSCREEN_SYNAPTICS_TCM_TAMA_CORE=y
CONFIG_TOUCHSCREEN_SYNAPTICS_TCM_TAMA_TOUCH=y
CONFIG_TOUCHSCREEN_SYNAPTICS_TCM_TAMA_DEVICE=y
CONFIG_TOUCHSCREEN_SYNAPTICS_TCM_TAMA_REFLASH=y
CONFIG_TOUCHSCREEN_SYNAPTICS_TCM_TAMA_RECOVERY=y
```

## base_tone_dora_defconfig
```kconfig
CONFIG_MACH_SONY_DORA=y
CONFIG_LEDS_TRIGGER_BACKLIGHT=y
CONFIG_LEDS_TRIGGER_DEFAULT_ON=y
```

## base_tone_keyaki_defconfig
```kconfig
CONFIG_MACH_SONY_KEYAKI=y
CONFIG_INPUT_STMVL53L0=y
CONFIG_LEDS_TRIGGER_BACKLIGHT=y
CONFIG_LEDS_TRIGGER_DEFAULT_ON=y
```
