## base_sm8250_defconfig
```kconfig
#  KEEP ALPHABETICALLY SORTED
# CONFIG_ARM64_VHE is not set
# CONFIG_COMPAT_BRK is not set
# CONFIG_CORE_DUMP_DEFAULT_ELF_HEADERS is not set
# CONFIG_DEBUG_PREEMPT is not set
# CONFIG_DEVPORT is not set
# CONFIG_EFI is not set
# CONFIG_INPUT_MOUSE is not set
# CONFIG_LEGACY_PTYS is not set
# CONFIG_LOCALVERSION_AUTO is not set
# CONFIG_LOGO_LINUX_MONO is not set
# CONFIG_LOGO_LINUX_VGA16 is not set
# CONFIG_NETFILTER_XT_MATCH_L2TP is not set
# CONFIG_NETFILTER_XT_MATCH_SCTP is not set
# CONFIG_NVMEM_SYSFS is not set
# CONFIG_PID_NS is not set
# CONFIG_PM_WAKELOCKS_GC is not set
# CONFIG_RD_LZ4 is not set
# CONFIG_RD_LZO is not set
# CONFIG_RD_XZ is not set
# CONFIG_SERIAL_DEV_CTRL_TTYPORT is not set
# CONFIG_SERIO_SERPORT is not set
# CONFIG_SLUB_DEBUG is not set
# CONFIG_TOUCHSCREEN_ST is not set
# CONFIG_USB_GSPCA is not set
# CONFIG_ZONE_DMA32 is not set
CONFIG_ARCH_KONA=y
CONFIG_ARCH_QCOM=y
CONFIG_ARCH_SONY_EDO=y
CONFIG_ARM64_CRYPTO=y
CONFIG_ARM64_LSE_ATOMICS=y
CONFIG_ARM64_SSBD=y
CONFIG_ARM64_SW_TTBR0_PAN=y
CONFIG_ARM_CPUIDLE=y
CONFIG_ARM_DSU_PMU=y
CONFIG_ARM_MEMLAT_MON=y
CONFIG_ARM_QCOM_CPUFREQ_HW=y
CONFIG_ARM_QCOM_DEVFREQ_FW=y
CONFIG_ARM_QCOM_DEVFREQ_QOSLAT=y
CONFIG_ARM_SMMU=y
CONFIG_ARMV8_DEPRECATED=y
CONFIG_BALANCE_ANON_FILE_RECLAIM=y
CONFIG_BFQ_GROUP_IOSCHED=y
CONFIG_BLK_CGROUP=y
CONFIG_BLK_DEV_DM=y
CONFIG_BLK_DEV_LOOP_MIN_COUNT=16
CONFIG_BLK_DEV_RAM_SIZE=8192
CONFIG_BLK_DEV_RAM=y
CONFIG_BLK_DEV_SD=y
CONFIG_BLK_INLINE_ENCRYPTION_FALLBACK=y
CONFIG_BLK_INLINE_ENCRYPTION=y
CONFIG_BONDING=y
CONFIG_BPF_JIT_ALWAYS_ON=y
CONFIG_BRIDGE_EBT_BROUTE=y
CONFIG_BRIDGE_NF_EBTABLES=y
CONFIG_BRIDGE=y
CONFIG_BT_SLIM_QCA6390=y
CONFIG_BT=y
CONFIG_BUILD_ARM64_APPENDED_DTB_IMAGE=y
CONFIG_BUILD_ARM64_DT_OVERLAY=y
CONFIG_BUS_AUTO_SUSPEND=y
CONFIG_CFG80211_INTERNAL_REGDB=y
CONFIG_CFG80211=y
CONFIG_CFQ_GROUP_IOSCHED=y
CONFIG_CHR_DEV_SCH=y
CONFIG_CHR_DEV_SG=y
CONFIG_CLD_LL_CORE=y
CONFIG_CLS_U32_MARK=y
CONFIG_CMA_AREAS=16
CONFIG_CMA_DEBUGFS=y
CONFIG_CMA=y
CONFIG_CNSS2_QMI=y
CONFIG_CNSS2=y
CONFIG_CNSS_ASYNC=y
CONFIG_CNSS_GENL=y
CONFIG_COMPAT=y
CONFIG_CORESIGHT_REMOTE_ETM=y
CONFIG_CORESIGHT_TGU=y
CONFIG_CORESIGHT=y
CONFIG_CP15_BARRIER_EMULATION=y
CONFIG_CPU_BOOST=y
CONFIG_CPU_FREQ_GOV_CONSERVATIVE=y
CONFIG_CPU_FREQ_GOV_ONDEMAND=y
CONFIG_CPU_FREQ_GOV_POWERSAVE=y
CONFIG_CPU_FREQ_GOV_SCHEDUTIL=y
CONFIG_CPU_FREQ_GOV_USERSPACE=y
CONFIG_CPU_FREQ_STAT=y
CONFIG_CPU_FREQ_TIMES=y
CONFIG_CPU_FREQ=y
CONFIG_CPU_IDLE=y
CONFIG_CPUSETS=y
CONFIG_CPU_THERMAL=y
CONFIG_CRYPTO_AES_ARM64_CE_BLK=y
CONFIG_CRYPTO_AES_ARM64_CE_CCM=y
CONFIG_CRYPTO_AES_ARM64_NEON_BLK=y
CONFIG_CRYPTO_ANSI_CPRNG=y
CONFIG_CRYPTO_CCM=y
CONFIG_CRYPTO_DEV_QCEDEV=y
CONFIG_CRYPTO_DEV_QCOM_MSM_QCE=y
CONFIG_CRYPTO_DEV_QCRYPTO=y
CONFIG_CRYPTO_GHASH_ARM64_CE=y
CONFIG_CRYPTO_LZ4=y
CONFIG_CRYPTO_SHA1_ARM64_CE=y
CONFIG_CRYPTO_SHA2_ARM64_CE=y
CONFIG_CRYPTO_TWOFISH=y
CONFIG_DEBUG_ALIGN_RODATA=y
CONFIG_DEBUG_FS=y
CONFIG_DEBUG_INFO=y
CONFIG_DEVFREQ_GOV_CDSPL3=y
CONFIG_DEVFREQ_GOV_MEMLAT=y
CONFIG_DEVFREQ_GOV_PASSIVE=y
CONFIG_DEVFREQ_GOV_QCOM_BW_HWMON=y
CONFIG_DEVFREQ_GOV_QCOM_CACHE_HWMON=y
CONFIG_DEVFREQ_GOV_STATICMAP=y
CONFIG_DEVFREQ_SIMPLE_DEV=y
CONFIG_DEVFREQ_THERMAL=y
CONFIG_DIAG_CHAR=y
CONFIG_DMA_CMA=y
CONFIG_DMADEVICES=y
CONFIG_DM_DEFAULT_KEY=y
CONFIG_DM_UEVENT=y
CONFIG_DM_VERITY_FEC=y
CONFIG_DRM_LONTIUM_LT9611UXC=y
CONFIG_DRM=y
CONFIG_DVB_MPQ_DEMUX=y
CONFIG_DVB_MPQ=y
CONFIG_DVB_MPQ_SW=y
CONFIG_DYNAMIC_DEBUG=y
CONFIG_ECRYPT_FS_MESSAGING=y
CONFIG_ECRYPT_FS=y
CONFIG_EDAC_KRYO_ARM64_PANIC_ON_UE=y
CONFIG_EDAC_KRYO_ARM64=y
CONFIG_EDAC_QCOM_LLCC_PANIC_ON_UE=y
CONFIG_EDAC_QCOM=y
CONFIG_EDAC=y
CONFIG_ENERGY_MODEL=y
CONFIG_ESOC_CLIENT=y
CONFIG_ESOC_DEV=y
CONFIG_ESOC_MDM_4x=y
CONFIG_ESOC_MDM_DRV=y
CONFIG_ESOC=y
CONFIG_EXT4_ENCRYPTION=y
CONFIG_EXT4_FS_POSIX_ACL=y
CONFIG_EXT4_FS_SECURITY=y
CONFIG_EXT4_FS=y
CONFIG_F2FS_FS_SECURITY=y
CONFIG_F2FS_FS=y
CONFIG_FB_ARMCLCD=y
CONFIG_FORTIFY_SOURCE=y
CONFIG_FS_ENCRYPTION_INLINE_CRYPT=y
CONFIG_FW_LOADER_USER_HELPER_FALLBACK=y
CONFIG_FW_LOADER_USER_HELPER=y
CONFIG_GPIO_SYSFS=y
CONFIG_GSI_REGISTER_VERSION_2=y
CONFIG_HARDEN_BRANCH_PREDICTOR=y
CONFIG_HAVE_USERSPACE_LOW_MEMORY_KILLER=y
CONFIG_HDCP_QSEECOM=y
CONFIG_HID_APPLE=y
CONFIG_HID_ELECOM=y
CONFIG_HID_LOGITECH=y
CONFIG_HID_MAGICMOUSE=y
CONFIG_HID_MICROSOFT=y
CONFIG_HID_MULTITOUCH=y
CONFIG_HID_NINTENDO=y
CONFIG_HID_PANTHERLORD=y
CONFIG_HID_PLANTRONICS=y
CONFIG_HID_QVR=y
CONFIG_HOTPLUG_SIZE_BITS=29
CONFIG_HW_RANDOM_MSM_LEGACY=y
CONFIG_HW_RANDOM=y
CONFIG_HWSPINLOCK_QCOM=y
CONFIG_HWSPINLOCK=y
CONFIG_I2C_CHARDEV=y
CONFIG_I2C_QCOM_GENI=y
CONFIG_I2C_RTC6226_QCA=y
CONFIG_I3C_MASTER_QCOM_GENI=y
CONFIG_I3C=y
CONFIG_IDTP9382A=y
CONFIG_IIO=y
CONFIG_IKHEADERS=y
CONFIG_INCREMENTAL_FS=y
CONFIG_INET6_AH=y
CONFIG_INET_AH=y
CONFIG_INET_IPCOMP=y
CONFIG_INPUT_MISC=y
CONFIG_INPUT_QPNP_POWER_ON=y
CONFIG_INPUT_QTI_HAPTICS=y
CONFIG_INPUT_TABLET=y
CONFIG_INPUT_TOUCHSCREEN=y
CONFIG_INPUT_UINPUT=y
CONFIG_IOMMU_IO_PGTABLE_FAST=y
CONFIG_ION_POOL_AUTO_REFILL=y
CONFIG_ION=y
CONFIG_IOSCHED_BFQ=y
CONFIG_IPA3_MHI_PRIME_MANAGER=y
CONFIG_IPA3_REGDUMP=y
CONFIG_IPA3=y
CONFIG_IPA_UT=y
CONFIG_IPA_WDI_UNIFIED_API=y
CONFIG_IPC_LOGGING=y
CONFIG_IP_NF_MATCH_AH=y
CONFIG_IP_NF_MATCH_RPFILTER=y
CONFIG_IP_PNP_DHCP=y
CONFIG_IP_PNP=y
CONFIG_IP_ROUTE_VERBOSE=y
CONFIG_IP_SCTP=y
CONFIG_IPV6_SUBTREES=y
CONFIG_IRQ_TIME_ACCOUNTING=y
CONFIG_JOYSTICK_XPAD_FF=y
CONFIG_JOYSTICK_XPAD_LEDS=y
CONFIG_KALLSYMS_ALL=y
CONFIG_KEYBOARD_GPIO=y
CONFIG_KRYO_PMU_WORKAROUND=y
CONFIG_L2TP_ETH=y
CONFIG_L2TP_IP=y
CONFIG_L2TP_V3=y
CONFIG_LEDS_CLASS=y
CONFIG_LEDS_QPNP_FLASH_V2=y
CONFIG_LEDS_QTI_TRI_LED=y
CONFIG_LEDS_TRIGGER_TIMER=y
CONFIG_LOCALVERSION="-perf"
CONFIG_LOG_BUF_SHIFT=18
CONFIG_LOG_CPU_MAX_BUF_SHIFT=17
CONFIG_LOGO=y
CONFIG_MAILBOX=y
CONFIG_MEDIA_CAMERA_SUPPORT=y
CONFIG_MEDIA_CONTROLLER=y
CONFIG_MEDIA_DIGITAL_TV_SUPPORT=y
CONFIG_MEDIA_RADIO_SUPPORT=y
CONFIG_MEDIA_SUPPORT=y
CONFIG_MEDIA_USB_SUPPORT=y
CONFIG_MEMCG_SWAP=y
CONFIG_MEMCG=y
CONFIG_MEMORY_HOTPLUG_DEFAULT_ONLINE=y
CONFIG_MEMORY_HOTPLUG_MOVABLE_NODE=y
CONFIG_MEMORY_HOTPLUG=y
CONFIG_MEMORY_HOTREMOVE=y
CONFIG_MFD_SPMI_PMIC=y
CONFIG_MHI_BUS=y
CONFIG_MHI_NETDEV=y
CONFIG_MHI_QCOM=y
CONFIG_MHI_SATELLITE=y
CONFIG_MHI_UCI=y
CONFIG_MMC_BLOCK_DEFERRED_RESUME=y
CONFIG_MMC_BLOCK_MINORS=32
CONFIG_MMC_CQHCI_CRYPTO_QTI=y
CONFIG_MMC_CQHCI_CRYPTO=y
CONFIG_MMC_SDHCI_MSM=y
CONFIG_MMC_SDHCI_PLTFM=y
CONFIG_MMC_SDHCI=y
CONFIG_MMC_TEST=y
CONFIG_MMC=y
CONFIG_MODULE_SIG_SHA512=y
CONFIG_MODULE_SIG=y
CONFIG_MSDOS_FS=y
CONFIG_MSM_ADSPRPC=y
CONFIG_MSM_BOOT_STATS=y
CONFIG_MSM_BT_POWER=y
CONFIG_MSM_CAMCC_KONA=y
CONFIG_MSM_CDSP_LOADER=y
CONFIG_MSM_CLK_AOP_QMP=y
CONFIG_MSM_CVP_V4L2=y
CONFIG_MSM_DEBUGCC_KONA=y
CONFIG_MSM_DISPCC_KONA=y
CONFIG_MSM_EVENT_TIMER=y
CONFIG_MSM_GLOBAL_SYNX=y
CONFIG_MSM_GPUCC_KONA=y
CONFIG_MSM_HSUSB_PHY=y
CONFIG_MSM_NPUCC_KONA=y
CONFIG_MSM_NPU=y
CONFIG_MSM_PERFORMANCE=y
CONFIG_MSM_PIL_SSR_GENERIC=y
CONFIG_MSM_PIL=y
CONFIG_MSM_PM=y
CONFIG_MSM_QBT_HANDLER=y
CONFIG_MSM_QMP=y
CONFIG_MSM_RDBG=m
CONFIG_MSM_SERVICE_LOCATOR=y
CONFIG_MSM_SERVICE_NOTIFIER=y
CONFIG_MSM_SPCOM=y
CONFIG_MSM_SPSS_UTILS=y
CONFIG_MSM_SUBSYSTEM_RESTART=y
CONFIG_MSM_SYSMON_QMI_COMM=y
CONFIG_MSM_TZ_LOG=y
CONFIG_MSM_VIDEOCC_KONA=y
CONFIG_NET_ACT_GACT=y
CONFIG_NET_ACT_MIRRED=y
CONFIG_NET_ACT_SKBEDIT=y
CONFIG_NET_CLS_FLOW=y
CONFIG_NET_CLS_FW=y
CONFIG_NET_EMATCH_CMP=y
CONFIG_NET_EMATCH_META=y
CONFIG_NET_EMATCH_NBYTE=y
CONFIG_NET_EMATCH_TEXT=y
CONFIG_NETFILTER_XT_MATCH_DSCP=y
CONFIG_NETFILTER_XT_MATCH_ESP=y
CONFIG_NETFILTER_XT_MATCH_MULTIPORT=y
CONFIG_NETFILTER_XT_TARGET_DSCP=y
CONFIG_NETFILTER_XT_TARGET_HARDIDLETIMER=y
CONFIG_NETFILTER_XT_TARGET_LOG=y
CONFIG_NETFILTER_XT_TARGET_NOTRACK=y
CONFIG_NETFILTER_XT_TARGET_TEE=y
CONFIG_NET_SCH_MULTIQ=y
CONFIG_NET_SCH_NETEM=y
CONFIG_NET_SCH_PRIO=y
CONFIG_NEW_LEDS=y
CONFIG_NFC_NQ=y
CONFIG_NLS_CODEPAGE_437=y
CONFIG_NLS_ISO8859_1=y
CONFIG_NLS_UTF8=y
CONFIG_NOP_USB_XCEIV=y
CONFIG_NR_CPUS=8
CONFIG_NVMEM_SPMI_SDAM=y
CONFIG_NVM_PBLK=y
CONFIG_NVM=y
CONFIG_OKL4_GUEST=y
CONFIG_OKL4_PIPE=y
CONFIG_OKL4_USER_VIRQ=y
CONFIG_OVERLAY_FS=y
CONFIG_OVERRIDE_MEMORY_LIMIT=y
CONFIG_PANIC_ON_OOPS=y
CONFIG_PANIC_ON_REFCOUNT_ERROR=y
CONFIG_PANIC_ON_SSR_NOTIF_TIMEOUT=y
CONFIG_PANIC_TIMEOUT=-1
CONFIG_PARTITION_ADVANCED=y
CONFIG_PCI_MSM_MSI=y
CONFIG_PCI_MSM=y
CONFIG_PCI=y
CONFIG_PINCTRL_KONA=y
CONFIG_PINCTRL_QCOM_SPMI_PMIC=y
CONFIG_PINCTRL_SOMC=y
CONFIG_PM_WAKELOCKS_LIMIT=0
CONFIG_POWER_RESET_QCOM=y
CONFIG_POWER_RESET_SYSCON=y
CONFIG_POWER_RESET_XGENE=y
CONFIG_PRINTK_TIME=y
CONFIG_PSTORE_CONSOLE=y
CONFIG_PSTORE_PMSG=y
CONFIG_PSTORE_RAM=y
CONFIG_PSTORE=y
CONFIG_PWM_QTI_LPG=y
CONFIG_PWM=y
CONFIG_QCOM_APCS_IPC=y
CONFIG_QCOM_BIMC_BWMON=y
CONFIG_QCOM_BUS_CONFIG_RPMH=y
CONFIG_QCOM_BUS_SCALING=y
CONFIG_QCOM_CDSP_RM=y
CONFIG_QCOM_CLK_RPMH=y
CONFIG_QCOM_COMMAND_DB=y
CONFIG_QCOM_DCC_V2=y
CONFIG_QCOM_DEVFREQ_DEVBW=y
CONFIG_QCOM_EARLY_RANDOM=y
CONFIG_QCOM_EUD=y
CONFIG_QCOM_FORCE_WDOG_BITE_ON_PANIC=y
CONFIG_QCOM_GENI_SE=y
CONFIG_QCOM_GLINK_PKT=y
CONFIG_QCOM_GLINK=y
CONFIG_QCOM_GPI_DMA=y
CONFIG_QCOM_INITIAL_LOGBUF=y
CONFIG_QCOM_IPCC=y
CONFIG_QCOM_KGSL=y
CONFIG_QCOM_KONA_LLCC=y
CONFIG_QCOM_LAZY_MAPPING=y
CONFIG_QCOM_LLCC_PERFMON=m
CONFIG_QCOM_LLCC_PMU=y
CONFIG_QCOM_LLCC=y
CONFIG_QCOM_MDT_LOADER=y
CONFIG_QCOM_MEM_OFFLINE=y
CONFIG_QCOM_MEMORY_DUMP_V2=y
CONFIG_QCOM_MINIDUMP=y
CONFIG_QCOM_PDC=y
CONFIG_QCOM_QDSS_BRIDGE=y
CONFIG_QCOM_QFPROM=y
CONFIG_QCOM_QHEE_ENABLE_MEM_PROTECTION=y
CONFIG_QCOM_QMI_DFC=y
CONFIG_QCOM_QMI_HELPERS=y
CONFIG_QCOM_QMI_POWER_COLLAPSE=y
CONFIG_QCOM_QMI_RMNET=y
CONFIG_QCOM_RPMH=y
CONFIG_QCOM_RTB_SEPARATE_CPUS=y
CONFIG_QCOM_RTB=y
CONFIG_QCOM_RUN_QUEUE_STATS=y
CONFIG_QCOM_SECURE_BUFFER=y
CONFIG_QCOM_SMCINVOKE=y
CONFIG_QCOM_SMEM=y
CONFIG_QCOM_SMP2P_SLEEPSTATE=y
CONFIG_QCOM_SMP2P=y
CONFIG_QCOM_SPMI_ADC5=y
CONFIG_QCOM_SPMI_TEMP_ALARM=y
CONFIG_QCOM_WATCHDOG_V2=y
CONFIG_QMP_DEBUGFS_CLIENT=y
CONFIG_QPNP_FG_GEN4=y
CONFIG_QPNP_PBS=y
CONFIG_QPNP_REVID=y
CONFIG_QPNP_SMB5=y
CONFIG_QPNP_USB_PDPHY=y
CONFIG_QRTR_MHI=y
CONFIG_QRTR_SMD=y
CONFIG_QRTR=y
CONFIG_QSEECOM=y
CONFIG_QSEE_IPC_IRQ_BRIDGE=y
CONFIG_QTEE_SHM_BRIDGE=y
CONFIG_QTI_ADC_TM=y
CONFIG_QTI_BCL_PMIC5=y
CONFIG_QTI_BCL_SOC_DRIVER=y
CONFIG_QTI_CPU_ISOLATE_COOLING_DEVICE=y
CONFIG_QTI_CRYPTO_COMMON=y
CONFIG_QTI_CRYPTO_TZ=y
CONFIG_QTI_DDR_STATS_LOG=y
CONFIG_QTI_LIMITS_ISENSE_CDSP=y
CONFIG_QTI_MAXIM_FAN_CONTROLLER=y
CONFIG_QTI_QMI_COOLING_DEVICE=y
CONFIG_QTI_QMI_SENSOR=y
CONFIG_QTI_RPM_STATS_LOG=y
CONFIG_QTI_THERMAL_LIMITS_DCVS=y
CONFIG_QTI_VIRTUAL_SENSOR=y
CONFIG_QTI_XR_SMRTVWR_MISC=y
CONFIG_QUOTA_NETLINK_INTERFACE=y
CONFIG_RADIO_SILABS=y
CONFIG_RANDOMIZE_BASE=y
CONFIG_RAS=y
CONFIG_RCU_BOOST=y
CONFIG_RCU_EXPERT=y
CONFIG_RCU_FAST_NO_HZ=y
CONFIG_RCU_NOCB_CPU=y
CONFIG_REGMAP_ALLOW_WRITE_DEBUGFS=y
CONFIG_REGMAP_WCD_IRQ=y
CONFIG_REGULATOR_FIXED_VOLTAGE=y
CONFIG_REGULATOR_PROXY_CONSUMER=y
CONFIG_REGULATOR_QPNP_AMOLED=y
CONFIG_REGULATOR_QPNP_LCDB=y
CONFIG_REGULATOR_REFGEN=y
CONFIG_REGULATOR_RPMH=y
CONFIG_REGULATOR_STUB=y
CONFIG_REGULATOR=y
CONFIG_RFKILL=y
CONFIG_RMNET_CTL=y
CONFIG_RMNET_IPA3=y
CONFIG_RMNET=y
CONFIG_RNDIS_IPA=y
CONFIG_RPMSG_CHAR=y
CONFIG_RPMSG_QCOM_GLINK_SMEM=y
CONFIG_RPMSG_QCOM_GLINK_SPSS=y
CONFIG_RTC_DRV_PM8XXX=y
CONFIG_SCHED_AUTOGROUP=y
CONFIG_SCHED_CORE_CTL=y
CONFIG_SCHED_MC=y
CONFIG_SCHEDSTATS=y
CONFIG_SCHED_TUNE=y
CONFIG_SCHED_WALT=y
CONFIG_SCSI_CONSTANTS=y
CONFIG_SCSI_LOGGING=y
CONFIG_SCSI_SCAN_ASYNC=y
CONFIG_SCSI_UFS_CRYPTO_QTI=y
CONFIG_SCSI_UFS_CRYPTO=y
CONFIG_SCSI_UFSHCD_PLATFORM=y
CONFIG_SCSI_UFSHCD=y
CONFIG_SCSI_UFS_QCOM=y
CONFIG_SCSI=y
CONFIG_SDCARD_FS=y
CONFIG_SECURITY_APPARMOR_BOOTPARAM_VALUE=0
CONFIG_SECURITY_APPARMOR=y
CONFIG_SECURITY_PERF_EVENTS_RESTRICT=y
CONFIG_SECURITY_SMACK=y
CONFIG_SENSORS_SSC=y
CONFIG_SERIAL_DEV_BUS=y
CONFIG_SERIAL_MSM_GENI_HALF_SAMPLING=y
CONFIG_SERIAL_MSM_GENI=y
CONFIG_SETEND_EMULATION=y
CONFIG_SETUP_SSR_NOTIF_TIMEOUTS=y
CONFIG_SKY2=y
CONFIG_SLAB_FREELIST_HARDENED=y
CONFIG_SLAB_FREELIST_RANDOM=y
CONFIG_SLIMBUS_MSM_NGD=y
CONFIG_SMSC911X=y
CONFIG_SND_DYNAMIC_MINORS=y
CONFIG_SND_SOC=y
CONFIG_SND_SOC_CS35L41=y         
CONFIG_SND_SOC_CS35L41_I2C=y
CONFIG_SND_USB_AUDIO_QMI=y
CONFIG_SND_USB_AUDIO=y
CONFIG_SOCKEV_NLMCAST=y
CONFIG_SOMC_CHARGER_EXTENSION=y
CONFIG_SPI_QCOM_GENI=y
CONFIG_SPI_SPIDEV=y
CONFIG_SPI=y
CONFIG_SPMI_PMIC_CLKDIV=y
CONFIG_SPMI=y
CONFIG_SPS_SUPPORT_NDP_BAM=y
CONFIG_SPS=y
CONFIG_SSR_SUBSYS_NOTIF_TIMEOUT=20000
CONFIG_SSR_SYSMON_NOTIF_TIMEOUT=20000
CONFIG_STATIC_USERMODEHELPER_PATH=""
CONFIG_SWP_EMULATION=y
CONFIG_SYN_COOKIES=y
CONFIG_TABLET_USB_ACECAD=y
CONFIG_TABLET_USB_AIPTEK=y
CONFIG_TABLET_USB_GTCO=y
CONFIG_TABLET_USB_HANWANG=y
CONFIG_TABLET_USB_KBTAB=y
CONFIG_THERMAL_GOV_LOW_LIMITS=y
CONFIG_THERMAL_GOV_USER_SPACE=y
CONFIG_THERMAL_TSENS=y
CONFIG_THERMAL_WRITABLE_TRIPS=y
CONFIG_THERMAL=y
CONFIG_TMPFS_POSIX_ACL=y
CONFIG_TMPFS=y
CONFIG_TOUCHSCREEN_FTS=y
CONFIG_TOUCHSCREEN_SAMSUNG_INCELL=y
CONFIG_TYPEC=y
CONFIG_UIO=y
CONFIG_USB_ACM=y
CONFIG_USB_ANNOUNCE_NEW_DEVICES=y
CONFIG_USB_BAM=y
CONFIG_USB_CONFIGFS_F_CCID=y
CONFIG_USB_CONFIGFS_F_CDEV=y
CONFIG_USB_CONFIGFS_F_DIAG=y
CONFIG_USB_CONFIGFS_F_GSI=y
CONFIG_USB_CONFIGFS_F_HID=y
CONFIG_USB_CONFIGFS_F_MTP=y
CONFIG_USB_CONFIGFS_F_PTP=y
CONFIG_USB_CONFIGFS_F_QDSS=y
CONFIG_USB_CONFIGFS_F_UAC2=y
CONFIG_USB_CONFIGFS_MASS_STORAGE=y
CONFIG_USB_DWC3_MSM=y
CONFIG_USB_DWC3=y
CONFIG_USB_EHCI_HCD_PLATFORM=y
CONFIG_USB_EHCI_HCD=y
CONFIG_USB_EHSET_TEST_FIXTURE=y
CONFIG_USB_GADGET_VBUS_DRAW=900
CONFIG_USB_HIDDEV=y
CONFIG_USB_ISP1760_HOST_ROLE=y
CONFIG_USB_ISP1760=y
CONFIG_USB_LINK_LAYER_TEST=y
CONFIG_USB_MSM_SSPHY_QMP=y
CONFIG_USB_NET_SMSC75XX=y
CONFIG_USB_NET_SMSC95XX=y
CONFIG_USB_OHCI_HCD_PLATFORM=y
CONFIG_USB_OHCI_HCD=y
CONFIG_USB_PD_POLICY=y
CONFIG_USB_QCOM_EMU_PHY=y
CONFIG_USB_RTL8150=y
CONFIG_USB_RTL8152=y
CONFIG_USB_SERIAL_CP210X=y
CONFIG_USB_SERIAL_FTDI_SIO=y
CONFIG_USB_SERIAL=y
CONFIG_USB_SOMC_SLG4R41505=y
CONFIG_USB_STORAGE=y
CONFIG_USB_USBNET=y
CONFIG_USB_XHCI_HCD=y
CONFIG_V4L_PLATFORM_DRIVERS=y
CONFIG_VFAT_FS=y
CONFIG_VIDEO_FIXED_MINOR_RANGES=y
CONFIG_VIDEO_V4L2_SUBDEV_API=y
CONFIG_VIDEO_V4L2_VIDEOBUF2_CORE=y
CONFIG_WCNSS_MEM_PRE_ALLOC=y
CONFIG_ZRAM=y
CONFIG_ZSMALLOC=y

# WARNING: Please do *not* reorder nor clean-up this one!
#
# Qualcomm Atheros CLD WLAN module
#
CONFIG_QCA_CLD_WLAN=y
CONFIG_QCACLD_WLAN_LFR3=y
# CONFIG_PRIMA_WLAN_OKC is not set
# CONFIG_PRIMA_WLAN_11AC_HIGH_TP is not set
CONFIG_WLAN_FEATURE_11W=y
CONFIG_WLAN_FEATURE_LPSS=y
CONFIG_QCOM_VOWIFI_11R=y
CONFIG_QCACLD_FEATURE_NAN=y
CONFIG_WLAN_FEATURE_NAN_DATAPATH=y
CONFIG_QCACLD_FEATURE_GREEN_AP=y
CONFIG_HELIUMPLUS=y
CONFIG_64BIT_PADDR=y
CONFIG_QCOM_TDLS=y
CONFIG_QCOM_LTE_COEX=y
# CONFIG_MPC_UT_FRAMEWORK is not set
CONFIG_WLAN_OFFLOAD_PACKETS=y
# CONFIG_WLAN_FEATURE_MEMDUMP is not set
CONFIG_FEATURE_TSO=y
# CONFIG_FEATURE_TSO_DEBUG is not set
CONFIG_WLAN_FASTPATH=y
CONFIG_WLAN_NAPI=y
# CONFIG_WLAN_NAPI_DEBUG is not set
# CONFIG_WLAN_TX_FLOW_CONTROL_V2 is not set
CONFIG_WLAN_SYNC_TSF=y
CONFIG_LFR_SUBNET_DETECTION=y
CONFIG_MCC_TO_SCC_SWITCH=y
# CONFIG_QCACLD_WLAN_LFR2 is not set
CONFIG_FEATURE_DP_TRACE=y
```
