## base_kalama_defconfig
```kconfig
CONFIG_LOCALVERSION="-sodp"
CONFIG_TIME_KUNIT_TEST=y
CONFIG_MSM_SYSSTATS=y
CONFIG_MSM_SYSSTATS_STUB_NONEXPORTED_SYMBOLS=y
CONFIG_IKHEADERS=y
CONFIG_LOG_BUF_SHIFT=20
CONFIG_LOG_CPU_MAX_BUF_SHIFT=0
CONFIG_ARCH_KALAMA=y
# CONFIG_ARM64_AMU_EXTN is not set
CONFIG_CPU_IDLE_GOV_QCOM_LPM=y
CONFIG_ARM_QCOM_CPUFREQ_HW=y
CONFIG_GH_ARM64_DRV=y
# CONFIG_MODULE_SIG_ALL is not set
CONFIG_CMA_DEBUG=y
CONFIG_TLS=y
CONFIG_TIPC=y
CONFIG_L2TP=y
CONFIG_VLAN_8021Q=y
CONFIG_6LOWPAN=y
CONFIG_IEEE802154=y
CONFIG_IEEE802154_6LOWPAN=y
CONFIG_MAC802154=y
CONFIG_VIRTIO_VSOCKETS=y
CONFIG_QRTR=y
CONFIG_QRTR_SMD=y
CONFIG_QRTR_MHI=y
CONFIG_QRTR_GUNYAH=y
CONFIG_CAN=y
CONFIG_BT=y
CONFIG_BT_RFCOMM=y
CONFIG_BT_HIDP=y
CONFIG_BT_HCIBTSDIO=y
CONFIG_BT_HCIUART=y
CONFIG_CFG80211=y
CONFIG_NL80211_TESTMODE=y
CONFIG_RFKILL=y
CONFIG_NET_9P=y
CONFIG_NFC=y
CONFIG_NETDEV_ADDR_LIST_TEST=y
CONFIG_PCI_MSM=y
CONFIG_FW_LOADER_USER_HELPER_FALLBACK=y
CONFIG_REGMAP_KUNIT=y
CONFIG_REGMAP_QTI_DEBUGFS=y
CONFIG_REGMAP_QTI_DEBUGFS_ALLOW_WRITE=y
CONFIG_MHI_BUS=y
CONFIG_MHI_BUS_DEBUG=y
CONFIG_MHI_BUS_PCI_GENERIC=y
CONFIG_MHI_BUS_MISC=y
CONFIG_MHI_UCI=y
CONFIG_MHI_DTR=y
CONFIG_QCOM_SI_CORE=y
CONFIG_QCOM_SI_CORE_WQ=y
CONFIG_QCOM_SI_CORE_MEM_OBJECT=y
CONFIG_ZRAM=y
CONFIG_VIRTIO_BLK=y
CONFIG_OPEN_DICE=y
CONFIG_VCPU_STALL_DETECTOR=y
CONFIG_QSEECOM_PROXY=y
CONFIG_CHR_DEV_SG=y
CONFIG_MACSEC=y
CONFIG_CAN_VCAN=y
CONFIG_CAN_SLCAN=y
CONFIG_PPP=y
CONFIG_PPP_BSDCOMP=y
CONFIG_PPP_DEFLATE=y
CONFIG_PPP_MPPE=y
CONFIG_PPTP=y
CONFIG_PPPOL2TP=y
CONFIG_USB_RTL8150=y
CONFIG_USB_RTL8152=y
CONFIG_USB_USBNET=y
CONFIG_USB_NET_CDC_EEM=y
CONFIG_USB_NET_AQC111=y
CONFIG_WWAN=y
CONFIG_INPUT_KUNIT_TEST=y
CONFIG_INPUT_PM8941_PWRKEY=y
CONFIG_INPUT_QPNP_POWER_ON=y
CONFIG_HVC_GUNYAH=y
CONFIG_MSM_RDBG=y
CONFIG_VIRTIO_CONSOLE=y
CONFIG_HW_RANDOM_CCTRNG=y
CONFIG_I2C_MSM_GENI=y
CONFIG_SPI_MSM_GENI=y
CONFIG_SPMI_MSM_PMIC_ARB=y
CONFIG_SPMI_MSM_PMIC_ARB_DEBUG=y
CONFIG_PINCTRL_MSM=y
CONFIG_PINCTRL_KALAMA=y
CONFIG_PINCTRL_QCOM_SPMI_PMIC=y
CONFIG_PINCTRL_SOMC=y
CONFIG_PINCTRL_SOMC_PMIC=y
CONFIG_POWER_RESET_QCOM_DOWNLOAD_MODE=y
CONFIG_POWER_RESET_QCOM_DOWNLOAD_MODE_DEFAULT=y
CONFIG_POWER_RESET_QCOM_PON=y
CONFIG_POWER_RESET_QCOM_REBOOT_REASON=y
CONFIG_QTI_BATTERY_CHARGER=y
CONFIG_SCHGM_FLASH=y
CONFIG_QCOM_TSENS=y
CONFIG_QCOM_SPMI_ADC_TM5=y
CONFIG_QCOM_SPMI_TEMP_ALARM=y
CONFIG_QTI_QMI_SENSOR_V2=y
CONFIG_QTI_POLICY_ENGINE_SENSOR=y
CONFIG_QTI_QMI_COOLING_DEVICE=y
CONFIG_QTI_BCL_PMIC5=y
CONFIG_QTI_BCL_SOC_DRIVER=y
CONFIG_QTI_USERSPACE_CDEV=y
CONFIG_QTI_CPU_HOTPLUG_COOLING_DEVICE=y
CONFIG_QTI_DDR_COOLING_DEVICE=y
CONFIG_QTI_CPUFREQ_CDEV=y
CONFIG_QTI_THERMALZONE_CONFIG_DEBUG=y
CONFIG_QTI_SDPM_CLOCK_MONITOR=y
CONFIG_QTI_CPU_PAUSE_COOLING_DEVICE=y
CONFIG_QTI_DEVFREQ_CDEV=y
CONFIG_QTI_THERMAL_VENDOR_HOOK=y
CONFIG_MFD_I2C_PMIC=y
CONFIG_MFD_SPMI_PMIC=y
CONFIG_REGULATOR_DEBUG_CONTROL=y
CONFIG_REGULATOR_QTI_FIXED_VOLTAGE=y
CONFIG_REGULATOR_PROXY_CONSUMER=y
CONFIG_REGULATOR_QCOM_AMOLED=y
CONFIG_REGULATOR_RPMH=y
CONFIG_REGULATOR_STUB=y
CONFIG_REGULATOR_QTI_OCP_NOTIFIER=y
CONFIG_DRM_MSM_HELPER=y
CONFIG_SND_USB_AUDIO_QMI=y
CONFIG_SND_SOC_TOPOLOGY_KUNIT_TEST=y
CONFIG_SND_SOC_UTILS_KUNIT_TEST=y
CONFIG_HID_KUNIT_TEST=y
CONFIG_USB_MON=y
CONFIG_USB_XHCI_SIDEBAND=y
CONFIG_USB_ACM=y
# CONFIG_USB_DWC3_HAPS is not set
# CONFIG_USB_DWC3_OF_SIMPLE is not set
# CONFIG_USB_DWC3_QCOM is not set
CONFIG_USB_DWC3_MSM=y
CONFIG_USB_SERIAL=y
CONFIG_USB_SERIAL_FTDI_SIO=y
CONFIG_USB_EHSET_TEST_FIXTURE=y
CONFIG_USB_LINK_LAYER_TEST=y
CONFIG_NOP_USB_XCEIV=y
CONFIG_USB_QCOM_EMU_PHY=y
CONFIG_USB_MSM_SSPHY_QMP=y
CONFIG_USB_MSM_EUSB2_PHY=y
CONFIG_USB_F_FS_IPC_LOGGING=y
CONFIG_USB_CONFIGFS_F_CDEV=y
CONFIG_USB_CONFIGFS_F_CCID=y
CONFIG_USB_CONFIGFS_F_QDSS=y
CONFIG_USB_CONFIGFS_F_GSI=y
CONFIG_UCSI_QTI_GLINK=y
CONFIG_USB_REPEATER=y
CONFIG_QTI_PMIC_EUSB2_REPEATER=y
CONFIG_MMC_SDHCI_MSM=y
CONFIG_SDHCI_MSM_DBG=y
CONFIG_MMC_CRYPTO_QTI=y
CONFIG_UFS_DBG=y
CONFIG_SCSI_UFS_QCOM=y
CONFIG_SCSI_UFS_CRYPTO_QTI=y
CONFIG_LEDS_QPNP_FLASH_V2=y
CONFIG_LEDS_QTI_TRI_LED=y
CONFIG_LEDS_QPNP_VIBRATOR_LDO=y
CONFIG_RTC_LIB_KUNIT_TEST=y
CONFIG_RTC_DRV_PM8XXX=y
CONFIG_QCOM_BAM_DMA=y
CONFIG_MSM_GPI_DMA=y
CONFIG_MSM_GPI_DMA_DEBUG=y
CONFIG_QCOM_DMABUF_HEAPS=y
CONFIG_QCOM_DMABUF_HEAPS_SYSTEM=y
CONFIG_QCOM_DMABUF_HEAPS_PAGE_POOL_REFILL=y
CONFIG_QCOM_DMABUF_HEAPS_SYSTEM_SECURE=y
CONFIG_QCOM_DMABUF_HEAPS_CMA=y
CONFIG_QCOM_DMABUF_HEAPS_CARVEOUT=y
CONFIG_UIO_MSM_SHAREDMEM=y
CONFIG_MTK_GZVM=y
CONFIG_GUNYAH_DRIVERS=y
CONFIG_GH_VIRT_WATCHDOG=y
CONFIG_GH_CTRL=y
CONFIG_GH_DBL=y
CONFIG_GH_MSGQ=y
CONFIG_GH_RM_DRV=y
CONFIG_GH_IRQ_LEND=y
CONFIG_GH_RM_BOOSTER=y
CONFIG_GH_MEM_NOTIFIER=y
CONFIG_GH_SECURE_VM_LOADER=y
CONFIG_GH_PROXY_SCHED=y
CONFIG_GH_PANIC_NOTIFIER=y
CONFIG_VIRTIO_PCI=y
CONFIG_VIRTIO_BALLOON=y
CONFIG_QCA_CLD_WLAN=y
CONFIG_EP_PCIE=y
CONFIG_COMMON_CLK_QCOM=y
CONFIG_QCOM_CLK_RPMH=y
CONFIG_QCOM_GDSC_REGULATOR=y
CONFIG_SM_GCC_KALAMA=y
CONFIG_SM_CAMCC_KALAMA=y
CONFIG_SM_DISPCC_KALAMA=y
CONFIG_SM_GPUCC_KALAMA=y
CONFIG_SM_TCSRCC_KALAMA=y
CONFIG_SM_VIDEOCC_KALAMA=y
CONFIG_SM_DEBUGCC_KALAMA=y
CONFIG_CLK_KUNIT_TEST=y
CONFIG_CLK_GATE_KUNIT_TEST=y
CONFIG_HWSPINLOCK_QCOM=y
CONFIG_QCOM_IPCC=y
CONFIG_IOMMU_IO_PGTABLE_FAST=y
CONFIG_ARM_SMMU=y
CONFIG_QTI_IOMMU_SUPPORT=y
CONFIG_QCOM_IOMMU_UTIL=y
CONFIG_QCOM_IOMMU_DEBUG=y
CONFIG_ARM_SMMU_SELFTEST=y
CONFIG_QCOM_LAZY_MAPPING=y
CONFIG_QCOM_Q6V5_PAS=y
CONFIG_QCOM_SPSS=y
CONFIG_QCOM_SYSMON=y
CONFIG_QCOM_PANIC_ON_NOTIF_TIMEOUT=y
CONFIG_RPROC_SYSMON_NOTIF_TIMEOUT=20000
CONFIG_RPROC_SSR_NOTIF_TIMEOUT=20000
CONFIG_QCOM_RPROC_BOTH_DUMPS=y
CONFIG_RPMSG_QCOM_GLINK_SMEM=y
CONFIG_QCOM_GLINK_PKT=y
CONFIG_RPMSG_QCOM_SMD=y
CONFIG_SPS=y
CONFIG_SPS_SUPPORT_NDP_BAM=y
CONFIG_QCOM_AOSS_QMP=y
CONFIG_QCOM_COMMAND_DB=y
CONFIG_QCOM_CPUSS_SLEEP_STATS=y
CONFIG_QCOM_DCC_V2=y
CONFIG_QCOM_CPUCP=y
CONFIG_QTI_CPUCP_LOG=y
CONFIG_GIC_INTERRUPT_ROUTING=y
CONFIG_QCOM_LLCC=y
CONFIG_QCOM_LLCC_PERFMON=y
CONFIG_QCOM_PANIC_ON_PDR_NOTIF_TIMEOUT=y
CONFIG_PDR_INDICATION_NOTIF_TIMEOUT=9000
CONFIG_QCOM_QFPROM_SYS=y
CONFIG_MEM_SHARE_QMI_SERVICE=y
CONFIG_QCOM_RPMH=y
CONFIG_QCOM_RUN_QUEUE_STATS=y
CONFIG_QCOM_SMEM=y
CONFIG_QCOM_MEMORY_DUMP_V2=y
CONFIG_QCOM_DYNAMIC_MEMORY_DUMP=y
CONFIG_QCOM_SMP2P=y
CONFIG_QCOM_SMP2P_SLEEPSTATE=y
CONFIG_QSEE_IPC_IRQ_BRIDGE=y
CONFIG_QTI_SYS_PM_VX=y
CONFIG_QCOM_SOCINFO=y
CONFIG_QCOM_CPU_PHYS_LOG_MAP=y
CONFIG_QCOM_STATS=y
CONFIG_QCOM_LOGBUF_VENDOR_HOOKS=y
CONFIG_QCOM_LOGBUF_BOOTLOG=y
CONFIG_QCOM_WDT_CORE=y
CONFIG_QCOM_SOC_WATCHDOG=y
CONFIG_QCOM_IRQ_STAT=y
CONFIG_QCOM_FORCE_WDOG_BITE_ON_PANIC=y
CONFIG_QCOM_PMU_LIB=y
CONFIG_QCOM_DCVS_FP=y
CONFIG_QCOM_DCVS=y
CONFIG_QCOM_MEMLAT=y
CONFIG_QCOM_BWMON=y
CONFIG_QCOM_SYSMON_SUBSYSTEM_STATS=y
CONFIG_QCOM_CDSP_RM=y
CONFIG_QCOM_CPU_VENDOR_HOOKS=y
CONFIG_MSM_BOOT_STATS=y
CONFIG_QCOM_EUD=y
CONFIG_GH_TLMM_VM_MEM_ACCESS=y
CONFIG_QCOM_RAMDUMP=y
CONFIG_QCOM_MINIDUMP=y
CONFIG_QCOM_VA_MINIDUMP=y
CONFIG_QCOM_MINIDUMP_FTRACE=y
CONFIG_QCOM_MINIDUMP_PANIC_DUMP=y
CONFIG_QCOM_MINIDUMP_PANIC_MEMORY_INFO=y
CONFIG_QCOM_MINIDUMP_PANIC_CPUFREQ_INFO=y
CONFIG_QCOM_MINIDUMP_PSTORE=y
CONFIG_QCOM_HUNG_TASK_ENH=y
CONFIG_QCOM_SECURE_BUFFER=y
CONFIG_QCOM_FSA4480_I2C=y
CONFIG_QCOM_MEM_BUF=y
CONFIG_QCOM_MEM_BUF_GH=y
CONFIG_QCOM_MEM_BUF_MSGQ=y
CONFIG_MSM_TMECOM_QMP=y
CONFIG_QCOM_MEM_OFFLINE=y
CONFIG_QCOM_PANEL_EVENT_NOTIFIER=y
CONFIG_QTI_PMIC_GLINK=y
CONFIG_QTI_PMIC_GLINK_CLIENT_DEBUG=y
CONFIG_QTI_ALTMODE_GLINK=y
CONFIG_QTI_BATTERY_GLINK_DEBUG=y
CONFIG_QTI_CHARGER_ULOG_GLINK=y
CONFIG_QTI_PMIC_GLINK_DEBUG=y
CONFIG_QTI_PMIC_PON_LOG=y
CONFIG_QCOM_VM_DMESG_DUMPER=y
CONFIG_QCOM_DEBUG_SYMBOL=y
CONFIG_MSM_PERFORMANCE=y
CONFIG_DEVFREQ_GOV_QCOM_ADRENO_TZ=y
CONFIG_DEVFREQ_GOV_QCOM_GPUBW_MON=y
CONFIG_QCOM_SPMI_ADC5_GEN3=y
CONFIG_QTI_GLINK_ADC=y
CONFIG_IIO_FORMAT_KUNIT_TEST=y
CONFIG_PWM_QTI_LPG=y
CONFIG_QCOM_PDC=y
CONFIG_QCOM_SHOW_RESUME_IRQ=y
CONFIG_PHY_QCOM_UFS=y
CONFIG_PHY_QCOM_UFS_QRBTC_SDM845=y
CONFIG_PHY_QCOM_UFS_V4_KALAMA=y
CONFIG_NVMEM_QCOM_QFPROM=y
CONFIG_NVMEM_SPMI_SDAM=y
CONFIG_SLIMBUS=y
CONFIG_SLIM_QCOM_NGD_CTRL=y
CONFIG_INTERCONNECT_QCOM_KALAMA=y
CONFIG_INTERCONNECT_QCOM_DEBUG=y
CONFIG_EXT4_KUNIT_TESTS=y
CONFIG_FAT_KUNIT_TEST=y
CONFIG_DEBUG_PAGEALLOC=y
CONFIG_DEBUG_PAGEALLOC_ENABLE_DEFAULT=y
CONFIG_DEBUG_SPINLOCK=y
CONFIG_LOCK_TORTURE_TEST=y
CONFIG_RCU_TORTURE_TEST=y
CONFIG_IPC_LOGGING=y
CONFIG_IPC_LOG_MINIDUMP_BUFFERS=16
CONFIG_KUNIT=y
CONFIG_KUNIT_TEST=y
CONFIG_KUNIT_EXAMPLE_TEST=y
CONFIG_LKDTM=y
CONFIG_ATOMIC64_SELFTEST=y
CONFIG_SCHED_WALT=y
CONFIG_SCHED_WALT_DEBUG=y
```

## base_pineapple_defconfig
```kconfig
CONFIG_LOCALVERSION="-sodp"
CONFIG_ARCH_PINEAPPLE=y
CONFIG_ARM_QCOM_CPUFREQ_HW=y
CONFIG_GH_ARM64_DRV=y
# CONFIG_MODULE_SIG_ALL is not set
CONFIG_CMA_DEBUG=y
CONFIG_QRTR=y
CONFIG_QRTR_SMD=y
CONFIG_QRTR_TUN=y
CONFIG_QRTR_MHI=y
CONFIG_CFG80211=y
CONFIG_NL80211_TESTMODE=y
# CONFIG_CFG80211_DEFAULT_PS is not set
# CONFIG_CFG80211_CRDA_SUPPORT is not set
CONFIG_MAC80211=y
# CONFIG_MAC80211_RC_MINSTREL is not set
CONFIG_PCI_MSM=y
CONFIG_FW_LOADER_USER_HELPER_FALLBACK=y
CONFIG_MHI_BUS=y
CONFIG_MHI_BUS_DEBUG=y
CONFIG_MHI_BUS_MISC=y
CONFIG_MHI_UCI=y
CONFIG_MHI_SATELLITE=y
CONFIG_QTI_SCMI_VENDOR_PROTOCOL=y
CONFIG_QSEECOM_PROXY=y
CONFIG_INPUT_PM8941_PWRKEY=y
CONFIG_SERIAL_MSM_GENI=y
CONFIG_HVC_GUNYAH=y
CONFIG_I2C_MSM_GENI=y
CONFIG_I3C_MASTER_MSM_GENI=y
CONFIG_Q2SPI_MSM_GENI=y
CONFIG_SPI_MSM_GENI=y
CONFIG_SPMI_MSM_PMIC_ARB=y
CONFIG_SPMI_MSM_PMIC_ARB_DEBUG=y
CONFIG_PINCTRL_MSM=y
CONFIG_PINCTRL_PINEAPPLE=y
CONFIG_PINCTRL_QCOM_SPMI_PMIC=y
CONFIG_PINCTRL_SOMC=y
CONFIG_PINCTRL_SOMC_PMIC=y
CONFIG_POWER_RESET_QCOM_DOWNLOAD_MODE=y
CONFIG_POWER_RESET_QCOM_DOWNLOAD_MODE_DEFAULT=y
CONFIG_POWER_RESET_QCOM_PON=y
CONFIG_POWER_RESET_QCOM_REBOOT_REASON=y
CONFIG_QTI_BATTERY_CHARGER=y
CONFIG_QCOM_SPMI_TEMP_ALARM=y
CONFIG_MFD_SPMI_PMIC=y
CONFIG_REGULATOR_DEBUG_CONTROL=y
CONFIG_REGULATOR_QTI_FIXED_VOLTAGE=y
CONFIG_REGULATOR_PROXY_CONSUMER=y
CONFIG_REGULATOR_RPMH=y
CONFIG_DRM_MSM_HELPER=y
CONFIG_USB_DWC3_MSM=y
CONFIG_USB_QCOM_EMU_PHY=y
CONFIG_USB_MSM_SSPHY_QMP=y
CONFIG_USB_MSM_EUSB2_PHY=y
CONFIG_USB_CONFIGFS_F_CDEV=y
CONFIG_USB_CONFIGFS_F_CCID=y
CONFIG_USB_CONFIGFS_F_QDSS=y
CONFIG_USB_CONFIGFS_F_GSI=y
CONFIG_UCSI_QTI_GLINK=y
CONFIG_USB_REPEATER=y
CONFIG_QTI_PMIC_EUSB2_REPEATER=y
CONFIG_SCSI_UFS_QCOM=y
CONFIG_SCSI_UFS_CRYPTO_QTI=y
CONFIG_LEDS_QTI_FLASH=y
CONFIG_LEDS_QCOM_LPG=y
CONFIG_RTC_DRV_PM8XXX=y
CONFIG_QCOM_BAM_DMA=y
CONFIG_MSM_GPI_DMA=y
CONFIG_MSM_GPI_DMA_DEBUG=y
CONFIG_QCOM_DMABUF_HEAPS=y
CONFIG_QCOM_DMABUF_HEAPS_SYSTEM=y
CONFIG_QCOM_DMABUF_HEAPS_PAGE_POOL_REFILL=y
CONFIG_QCOM_DMABUF_HEAPS_SYSTEM_SECURE=y
CONFIG_QCOM_DMABUF_HEAPS_CMA=y
CONFIG_QCOM_DMABUF_HEAPS_CARVEOUT=y
CONFIG_UIO_MSM_SHAREDMEM=y
CONFIG_GUNYAH_DRIVERS=y
CONFIG_GH_VIRT_WATCHDOG=y
CONFIG_GH_CTRL=y
CONFIG_GH_DBL=y
CONFIG_GH_MSGQ=y
CONFIG_GH_RM_DRV=y
CONFIG_GH_IRQ_LEND=y
CONFIG_GH_MEM_NOTIFIER=y
CONFIG_GH_SECURE_VM_LOADER=y
CONFIG_GH_PROXY_SCHED=y
CONFIG_COMMON_CLK_QCOM=y
CONFIG_QCOM_CLK_RPMH=y
CONFIG_SM_GCC_PINEAPPLE=y
CONFIG_SM_VIDEOCC_PINEAPPLE=y
CONFIG_SM_CAMCC_PINEAPPLE=y
CONFIG_SM_DISPCC_PINEAPPLE=y
CONFIG_SM_GPUCC_PINEAPPLE=y
CONFIG_SM_TCSRCC_PINEAPPLE=y
CONFIG_QCOM_GDSC_REGULATOR=y
CONFIG_HWSPINLOCK_QCOM=y
CONFIG_QCOM_IPCC=y
CONFIG_MSM_QMP=y
CONFIG_IOMMU_IO_PGTABLE_FAST=y
CONFIG_ARM_SMMU=y
CONFIG_QTI_IOMMU_SUPPORT=y
CONFIG_QCOM_IOMMU_UTIL=y
CONFIG_QCOM_IOMMU_DEBUG=y
CONFIG_QCOM_LAZY_MAPPING=y
CONFIG_QCOM_Q6V5_PAS=y
CONFIG_QCOM_SPSS=y
CONFIG_QCOM_SYSMON=y
CONFIG_RPMSG_QCOM_GLINK_RPM=y
CONFIG_RPMSG_QCOM_GLINK_SMEM=y
CONFIG_RPMSG_QCOM_GLINK_SPSS=y
CONFIG_QCOM_GLINK_PKT=y
CONFIG_RPMSG_QCOM_SMD=y
CONFIG_SPS=y
CONFIG_SPS_SUPPORT_NDP_BAM=y
CONFIG_QCOM_AOSS_QMP=y
CONFIG_QCOM_COMMAND_DB=y
CONFIG_QCOM_CRM=y
CONFIG_QCOM_DCC_V2=y
CONFIG_QCOM_CPUCP=y
CONFIG_QTI_CPUCP_LOG=y
CONFIG_QCOM_LLCC=y
CONFIG_QCOM_RPMH=y
CONFIG_QCOM_SMEM=y
CONFIG_QCOM_MEMORY_DUMP_V2=y
CONFIG_QCOM_SMP2P=y
CONFIG_QCOM_SOCINFO=y
CONFIG_QCOM_LOGBUF_VENDOR_HOOKS=y
CONFIG_QCOM_LOGBUF_BOOTLOG=y
CONFIG_QCOM_WDT_CORE=y
CONFIG_QCOM_FORCE_WDOG_BITE_ON_PANIC=y
CONFIG_QCOM_PMU_LIB=y
CONFIG_QCOM_DCVS_FP=y
CONFIG_QCOM_DCVS=y
CONFIG_QCOM_MEMLAT=y
CONFIG_QCOM_BWMON=y
CONFIG_QTI_QCOM_SCMI_CLIENT=y
CONFIG_QTI_C1DCVS_SCMI_V2=y
CONFIG_QTI_CPUFREQ_STATS_SCMI_V2=y
CONFIG_QCOM_RAMDUMP=y
CONFIG_QCOM_MINIDUMP=y
CONFIG_QCOM_VA_MINIDUMP=y
CONFIG_QCOM_MINIDUMP_FTRACE=y
CONFIG_QCOM_SECURE_BUFFER=y
CONFIG_QCOM_MEM_BUF=y
CONFIG_QCOM_MEM_BUF_GH=y
CONFIG_QCOM_MEM_BUF_MSGQ=y
CONFIG_QTI_PMIC_GLINK=y
CONFIG_QTI_PMIC_GLINK_CLIENT_DEBUG=y
CONFIG_QTI_ALTMODE_GLINK=y
CONFIG_QTI_BATTERY_GLINK_DEBUG=y
CONFIG_QTI_CHARGER_ULOG_GLINK=y
CONFIG_QTI_PMIC_GLINK_DEBUG=y
CONFIG_QCOM_WCD_USBSS_I2C=y
CONFIG_QCOM_DEBUG_SYMBOL=y
CONFIG_MSM_PERFORMANCE=y
CONFIG_DEVFREQ_GOV_QCOM_ADRENO_TZ=y
CONFIG_DEVFREQ_GOV_QCOM_GPUBW_MON=y
CONFIG_QTI_GLINK_ADC=y
CONFIG_QCOM_PDC=y
CONFIG_PHY_QCOM_UFS=y
CONFIG_PHY_QCOM_UFS_V4=y
CONFIG_QCOM_LLCC_PMU=y
CONFIG_NVMEM_QCOM_QFPROM=y
CONFIG_NVMEM_SPMI_SDAM=y
CONFIG_SLIMBUS=y
CONFIG_SLIM_QCOM_NGD_CTRL=y
CONFIG_INTERCONNECT_QCOM_PINEAPPLE=y
CONFIG_INTERCONNECT_QCOM_DEBUG=y
CONFIG_DEBUG_PAGEALLOC=y
CONFIG_DEBUG_PAGEALLOC_ENABLE_DEFAULT=y
CONFIG_DEBUG_SPINLOCK=y
CONFIG_LOCK_TORTURE_TEST=y
CONFIG_RCU_TORTURE_TEST=y
CONFIG_IPC_LOGGING=y
CONFIG_SCHED_WALT=y
```
