## base_sm6375_defconfig
```kconfig
CONFIG_LOCALVERSION="-sodp"
CONFIG_MSM_SYSSTATS=y
# CONFIG_ARCH_SUNXI is not set
# CONFIG_ARCH_HISI is not set
CONFIG_ARCH_BLAIR=y
# CONFIG_ARCH_SPRD is not set
# CONFIG_ARM64_AMU_EXTN is not set
CONFIG_BUILD_ARM64_UNCOMPRESSED_KERNEL=y
CONFIG_BUILD_ARM64_DT_OVERLAY=y
CONFIG_CPU_IDLE_GOV_QCOM_LPM=y
CONFIG_ARM_QCOM_CPUFREQ_HW=y
CONFIG_ARM_QCOM_CPUFREQ_HW_DEBUG=y
CONFIG_QTI_SCMI_SHARED_RAIL_PROTOCOL=y
CONFIG_GH_ARM64_DRV=y
CONFIG_LTO_CLANG_THIN=y
CONFIG_ZSMALLOC=y
CONFIG_QRTR=y
CONFIG_QRTR_SMD=y
CONFIG_QRTR_MHI=y
CONFIG_QRTR_GUNYAH=y
CONFIG_MSM_BT_POWER=y
CONFIG_BTFM_SLIM=y
CONFIG_CFG80211=y
CONFIG_NL80211_TESTMODE=y
CONFIG_NFC_QTI_I2C=y
CONFIG_PCI_MSM=y
CONFIG_DEVTMPFS=y
CONFIG_FW_LOADER_USER_HELPER_FALLBACK=y
CONFIG_REGMAP_QTI_DEBUGFS=y
CONFIG_MHI_NETDEV=y
CONFIG_MHI_UCI=y
CONFIG_MHI_DTR=y
CONFIG_MHI_BUS=y
CONFIG_MHI_BUS_MISC=y
CONFIG_ZRAM=y
CONFIG_QSEECOM=y
CONFIG_HDCP_QSEECOM=y
CONFIG_HAPTIC_NV=y
CONFIG_CHR_DEV_SG=y
CONFIG_SCSI_UFS_QCOM=y
CONFIG_SCSI_UFS_CRYPTO_QTI=y
CONFIG_CNSS_GENL=y
CONFIG_WCNSS_MEM_PRE_ALLOC=y
CONFIG_TOUCHSCREEN_SEC_TS=y
CONFIG_INPUT_PM8941_PWRKEY=y
CONFIG_INPUT_QPNP_POWER_ON=y
CONFIG_SENSORS_ET51X=y
# CONFIG_SERIAL_8250 is not set
# CONFIG_SERIAL_AMBA_PL011 is not set
# CONFIG_SERIAL_SAMSUNG is not set
CONFIG_SERIAL_MSM_GENI=y
# CONFIG_SERIAL_MSM_GENI_CONSOLE_DEFAULT_ENABLED is not set
CONFIG_SERIAL_MSM_GENI_CONSOLE=y
CONFIG_SERIAL_MSM_GENI_HALF_SAMPLING=y
CONFIG_HVC_GUNYAH=y
CONFIG_HW_RANDOM_MSM_LEGACY=y
CONFIG_MSM_ADSPRPC=y
CONFIG_MSM_RDBG=y
CONFIG_I2C_MSM_GENI=y
# CONFIG_I3C is not set
CONFIG_SPI_MSM_GENI=y
CONFIG_SPMI_MSM_PMIC_ARB=y
CONFIG_SPMI_MSM_PMIC_ARB_DEBUG=y
CONFIG_PINCTRL_BLAIR=y
CONFIG_PINCTRL_QCOM_SPMI_PMIC=y
CONFIG_POWER_RESET_MSM=y
CONFIG_IFPM_SM5038=y
CONFIG_SOMC_CHARGER_EXTENSION=y
CONFIG_QCOM_TSENS=y
CONFIG_QCOM_SPMI_TEMP_ALARM=y
CONFIG_QTI_ADC_TM=y
CONFIG_QTI_QMI_SENSOR_V2=y
CONFIG_QTI_BCL_PMIC5=y
CONFIG_QTI_BCL_SOC_DRIVER=y
CONFIG_QTI_QMI_COOLING_DEVICE=y
CONFIG_QTI_CPU_PAUSE_COOLING_DEVICE=y
CONFIG_QTI_POLICY_ENGINE_SENSOR=y
CONFIG_QTI_SDPM_CLOCK_MONITOR=y
CONFIG_QTI_CPU_HOTPLUG_COOLING_DEVICE=y
CONFIG_QTI_DDR_COOLING_DEVICE=y
CONFIG_QTI_USERSPACE_CDEV=y
CONFIG_QTI_CPUFREQ_CDEV=y
CONFIG_QTI_DEVFREQ_CDEV=y
CONFIG_QTI_AOP_REG_COOLING_DEVICE=y
CONFIG_MFD_SPMI_PMIC=y
CONFIG_REGULATOR_DEBUG_CONTROL=y
CONFIG_REGULATOR_QTI_FIXED_VOLTAGE=y
CONFIG_REGULATOR_PROXY_CONSUMER=y
CONFIG_REGULATOR_WL2868C=y
CONFIG_REGULATOR_REFGEN=y
CONFIG_REGULATOR_RPM_SMD=y
CONFIG_REGULATOR_STUB=y
CONFIG_QCOM_KGSL=y
CONFIG_QCOM_KGSL_CONTEXT_DEBUG=y
CONFIG_QCOM_KGSL_PROCESS_RECLAIM=y
CONFIG_SND_USB_AUDIO_QMI=y
# CONFIG_USB_DWC3_HAPS is not set
# CONFIG_USB_DWC3_OF_SIMPLE is not set
# CONFIG_USB_DWC3_QCOM is not set
CONFIG_USB_DWC3_MSM=y
CONFIG_USB_EHSET_TEST_FIXTURE=y
CONFIG_USB_LINK_LAYER_TEST=y
CONFIG_NOP_USB_XCEIV=y
CONFIG_USB_QCOM_EMU_PHY=y
CONFIG_MSM_HSUSB_PHY=y
CONFIG_USB_CONFIGFS_OBEX=y
CONFIG_USB_CONFIGFS_ECM_SUBSET=y
CONFIG_USB_CONFIGFS_F_LB_SS=y
CONFIG_USB_CONFIGFS_F_DIAG=y
CONFIG_USB_CONFIGFS_F_QDSS=y
CONFIG_USB_CONFIGFS_F_CCID=y
CONFIG_USB_CONFIGFS_F_CDEV=y
CONFIG_USB_CONFIGFS_F_GSI=y
CONFIG_SM5038_WATER_DETECTION_ENABLE=y
CONFIG_SM5038_SUPPORT_SBU=y
CONFIG_MMC_SDHCI_MSM=y
CONFIG_MMC_SDHCI_MSM_SCALING=y
CONFIG_MMC_CRYPTO_QTI=y
CONFIG_LEDS_AW2016=y
CONFIG_RTC_DRV_PM8XXX=y
CONFIG_QCOM_BAM_DMA=y
CONFIG_MSM_GPI_DMA=y
CONFIG_QCOM_DMABUF_HEAPS=y
CONFIG_QCOM_DMABUF_HEAPS_SYSTEM=y
CONFIG_QCOM_DMABUF_HEAPS_PAGE_POOL_REFILL=y
CONFIG_QCOM_DMABUF_HEAPS_SYSTEM_SECURE=y
CONFIG_QCOM_DMABUF_HEAPS_SYSTEM_UNCACHED=y
CONFIG_QCOM_DMABUF_HEAPS_CMA=y
CONFIG_QCOM_DMABUF_HEAPS_CARVEOUT=y
CONFIG_QCOM_DMABUF_HEAPS_BITSTREAM_CONTIG=y
CONFIG_UIO_MSM_SHAREDMEM=y
CONFIG_VIRT_DRIVERS=y
CONFIG_GUNYAH_DRIVERS=y
CONFIG_GH_CTRL=y
CONFIG_GH_MSGQ=y
CONFIG_GH_RM_DRV=y
CONFIG_GH_DBL=y
CONFIG_GH_IRQ_LEND=y
CONFIG_GH_MEM_NOTIFIER=y
CONFIG_GH_VIRT_WATCHDOG=y
CONFIG_GH_VIRTIO_BACKEND=y
CONFIG_QCA_CLD_WLAN=y
CONFIG_SPS=y
CONFIG_SPS_SUPPORT_NDP_BAM=y
CONFIG_IPA3=y
CONFIG_IPA_WDI_UNIFIED_API=y
CONFIG_USB_BAM=y
CONFIG_MSM_GENI_SE=y
CONFIG_MSM_11AD=y
CONFIG_COMMON_CLK_QCOM=y
CONFIG_QCOM_CLK_SMD_RPM=y
CONFIG_QCOM_CLK_RPMH=y
CONFIG_SPMI_PMIC_CLKDIV=y
CONFIG_SM_GPUCC_BLAIR=y
CONFIG_SM_DISPCC_BLAIR=y
CONFIG_SM_DEBUGCC_BLAIR=y
CONFIG_QCOM_GDSC_REGULATOR=y
CONFIG_HWSPINLOCK_QCOM=y
# CONFIG_SUN4I_TIMER is not set
# CONFIG_FSL_ERRATUM_A008585 is not set
# CONFIG_HISILICON_ERRATUM_161010101 is not set
# CONFIG_MTK_TIMER is not set
CONFIG_IOMMU_IO_PGTABLE_FAST=y
CONFIG_QTI_IOMMU_SUPPORT=y
CONFIG_ARM_SMMU=y
CONFIG_QCOM_LAZY_MAPPING=y
CONFIG_QCOM_IOMMU_UTIL=y
CONFIG_QCOM_IOMMU_DEBUG=y
CONFIG_QCOM_Q6V5_PAS=y
CONFIG_QCOM_SYSMON=y
CONFIG_QCOM_PANIC_ON_NOTIF_TIMEOUT=y
CONFIG_RPROC_SYSMON_NOTIF_TIMEOUT=20000
CONFIG_RPROC_SSR_NOTIF_TIMEOUT=20000
CONFIG_RPMSG_QCOM_GLINK_RPM=y
CONFIG_RPMSG_QCOM_GLINK_SMEM=y
CONFIG_RPMSG_QCOM_SMD=y
CONFIG_MSM_RPM_SMD=y
CONFIG_QCOM_COMMAND_DB=y
CONFIG_QCOM_CPUSS_SLEEP_STATS=y
CONFIG_QCOM_MEM_OFFLINE=y
CONFIG_QCOM_MEM_BUF=y
CONFIG_SHOW_SUSPEND_EPOCH=y
CONFIG_QCOM_MSM_IPCC=y
CONFIG_QCOM_PANIC_ON_PDR_NOTIF_TIMEOUT=y
CONFIG_PDR_INDICATION_NOTIF_TIMEOUT=9000
CONFIG_QCOM_RAMDUMP=y
CONFIG_MSM_BOOT_STATS=y
CONFIG_MEM_SHARE_QMI_SERVICE=y
CONFIG_QCOM_QFPROM_SYS=y
CONFIG_MSM_CORE_HANG_DETECT=y
CONFIG_QCOM_RPMH=y
CONFIG_QCOM_RPMHPD=y
CONFIG_QCOM_RUN_QUEUE_STATS=y
CONFIG_QCOM_SMEM=y
CONFIG_QCOM_SMD_RPM=y
CONFIG_QCOM_MEMORY_DUMP_V2=y
CONFIG_QCOM_SMP2P=y
CONFIG_QCOM_SOCINFO=y
CONFIG_QCOM_SOC_SLEEP_STATS=y
CONFIG_QCOM_DCC_V2=y
CONFIG_QCOM_MICRODUMP=y
CONFIG_QCOM_SECURE_BUFFER=y
CONFIG_QCOM_MEM_HOOKS=y
CONFIG_QCOM_GLINK_PKT=y
CONFIG_MSM_PERFORMANCE=y
CONFIG_QCOM_SMP2P_SLEEPSTATE=y
CONFIG_QCOM_GLINK=y
CONFIG_QTI_PMIC_PON_LOG=y
CONFIG_QCOM_PMU_LIB=y
CONFIG_QCOM_DCVS=y
CONFIG_QCOM_MEMLAT=y
CONFIG_QCOM_BWMON=y
CONFIG_QTI_SHARED_RAIL_CLIENT=y
CONFIG_QCOM_SUBSYSTEM_SLEEP_STATS=y
CONFIG_QCOM_SYSMON_SUBSYSTEM_STATS=y
CONFIG_QCOM_CDSP_RM=y
CONFIG_QCOM_WDT_CORE=y
CONFIG_QCOM_SOC_WATCHDOG=y
CONFIG_QCOM_IRQ_STAT=y
CONFIG_QCOM_LOGBUF_VENDOR_HOOKS=y
CONFIG_QCOM_FORCE_WDOG_BITE_ON_PANIC=y
CONFIG_QCOM_CPU_VENDOR_HOOKS=y
CONFIG_QCOM_HUNG_TASK_ENH=y
CONFIG_QCOM_SMCINVOKE=y
CONFIG_QTI_CRYPTO_COMMON=y
CONFIG_QTI_HW_KEY_MANAGER=y
CONFIG_QCOM_PANEL_EVENT_NOTIFIER=y
CONFIG_QCOM_BALANCE_ANON_FILE_RECLAIM=y
CONFIG_ICNSS2=y
CONFIG_ICNSS2_QMI=y
CONFIG_QCOM_SPEC_SYNC=y
CONFIG_MSM_TMECOM_QMP=y
CONFIG_QCOM_SPMI_ADC5=y
CONFIG_QCOM_SHOW_RESUME_IRQ=y
CONFIG_QCOM_PDC=y
CONFIG_QCOM_MPM=y
CONFIG_PHY_QCOM_UFS=y
CONFIG_PHY_QCOM_USB_SNPS_FEMTO_V2=y
CONFIG_QCOM_QFPROM=y
CONFIG_NVMEM_SPMI_SDAM=y
CONFIG_STM=y
CONFIG_STM_PROTO_BASIC=y
CONFIG_STM_PROTO_OST=y
CONFIG_STM_SOURCE_CONSOLE=y
CONFIG_STM_SOURCE_FTRACE=y
CONFIG_SLIM_QCOM_NGD_CTRL=y
CONFIG_INTERCONNECT_TEST=y
CONFIG_INTERCONNECT_QCOM=y
CONFIG_INTERCONNECT_QCOM_BLAIR=y
CONFIG_INTERCONNECT_QCOM_CPUCP_L3=y
CONFIG_INTERCONNECT_QCOM_DEBUG=y
CONFIG_TMPFS_POSIX_ACL=y
CONFIG_CRYPTO_DEV_QCOM_MSM_QCE=y
CONFIG_CRYPTO_DEV_QCRYPTO=y
CONFIG_CRYPTO_DEV_QCEDEV=y
CONFIG_IPC_LOGGING=y
CONFIG_IPC_LOG_MINIDUMP_BUFFERS=16
CONFIG_QCOM_RTB=y
CONFIG_QCOM_RTB_SEPARATE_CPUS=y
CONFIG_SCHED_WALT=y
```
