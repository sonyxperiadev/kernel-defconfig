## base_sdm845_defconfig
```kconfig
# CONFIG_COMMON_CLK_XGENE is not set
# CONFIG_CRYPTO_DEV_VIRTIO is not set
# CONFIG_HARDEN_BRANCH_PREDICTOR is not set
# CONFIG_HW_RANDOM_CAVIUM is not set
# CONFIG_INET_XFRM_MODE_BEET is not set
# CONFIG_MEMBARRIER is not set
# CONFIG_PRINT_QUOTA_WARNING is not set
# CONFIG_QCOM_QHEE_ENABLE_MEM_PROTECTION is not set
# CONFIG_RC_CORE is not set
# CONFIG_SDFAT_FS is not set
# CONFIG_SLUB_DEBUG is not set
# CONFIG_USB_PCI is not set
# CONFIG_VMAP_STACK is not set
CONFIG_ARCH_MMAP_RND_COMPAT_BITS=16
CONFIG_ARCH_SDM845=y
CONFIG_ARCH_SONY_TAMA=y
CONFIG_ARM64_ERRATUM_1286807=y
CONFIG_ARM64_SSBD=y
CONFIG_ARM_GIC_V3_REDISTRIBUTOR_HACK=y
CONFIG_BACKLIGHT_QCOM_WLED=y
CONFIG_BLK_DEV_IO_TRACE=y
CONFIG_BOOTPARAM_HUNG_TASK_PANIC=y
CONFIG_BOOTPARAM_SOFTLOCKUP_PANIC=y
CONFIG_BRIDGE_EBT_ARPREPLY=y
CONFIG_BRIDGE_EBT_ARP=y
CONFIG_BRIDGE_EBT_DNAT=y
CONFIG_BRIDGE_EBT_IP6=y
CONFIG_BRIDGE_EBT_IP=y
CONFIG_BRIDGE_EBT_SNAT=y
CONFIG_BRIDGE_EBT_T_FILTER=y
CONFIG_BRIDGE_EBT_T_NAT=y
CONFIG_BRIDGE_NETFILTER=y
CONFIG_BTFM_SLIM_WCN3990=y
CONFIG_BTFM_SLIM=y
CONFIG_BUILD_ARM64_DT_OVERLAY=y
CONFIG_CC_STACKPROTECTOR_REGULAR=y
CONFIG_CLOCK_CPU_OSM=y
CONFIG_CMA_DEBUGFS=y
CONFIG_COMPAT_VDSO=y
CONFIG_CPU_FREQ_DEFAULT_GOV_INTERACTIVE=y
CONFIG_CPU_IDLE_GOV_LADDER=y
CONFIG_DEBUG_OBJECTS_FREE=y
CONFIG_DEBUG_OBJECTS_PERCPU_COUNTER=y
CONFIG_DEBUG_OBJECTS_RCU_HEAD=y
CONFIG_DEBUG_OBJECTS_TIMERS=y
CONFIG_DEBUG_OBJECTS_WORK=y
CONFIG_DEBUG_OBJECTS=y
CONFIG_DEFAULT_HUNG_TASK_TIMEOUT=30
CONFIG_DEVFREQ_GOV_CDSPL3=y
CONFIG_DEVFREQ_SPDM=y
CONFIG_DRM_MSM_DP_SOMC_PANEL=y
CONFIG_ECM_IPA=y
CONFIG_EDAC_KRYO_ARM64_PANIC_ON_UE=y
CONFIG_EDAC_KRYO_ARM64=y
CONFIG_EDAC=y
CONFIG_ENCRYPTED_KEYS=y
CONFIG_EXTCON_GPIO=y
CONFIG_EXTCON_SOMC_EXTENSION=y
CONFIG_FPC1145_PLATFORM=y
CONFIG_GSI=y
CONFIG_HDCP_QSEECOM=y
CONFIG_I2C_MSM_V2=y
CONFIG_I2C_QCOM_GENI=y
CONFIG_ICNSS_DEBUG=y
CONFIG_IDTP9221=y
CONFIG_INPUT_QTI_HAPTICS=y
CONFIG_IPA3=y
CONFIG_IPA=y
CONFIG_L2TP_DEBUGFS=y
CONFIG_LCD_CLASS_DEVICE=y
CONFIG_LEDS_CLASS=y
CONFIG_LEDS_PCA9956B=y
CONFIG_LEDS_TRIGGER_BACKLIGHT=y
CONFIG_LEDS_TRIGGER_HEARTBEAT=y
CONFIG_LEDS_TRIGGER_ONESHOT=y
CONFIG_LEDS_TRIGGER_PANIC=y
CONFIG_LEDS_TRIGGERS=y
CONFIG_LEDS_TRIGGER_TIMER=y
CONFIG_LEDS_USER=y
CONFIG_LIMITS_LITE_HW=y
CONFIG_LIMITS_MONITOR=y
CONFIG_LOG_CPU_MAX_BUF_SHIFT=15
CONFIG_MEDIA_SUPPORT=y
CONFIG_MMC_SDHCI_MSM_LEGACY=y
CONFIG_MMC_SOMC_LOW_VOLTAGE=y
CONFIG_MSM_APM=y
CONFIG_MSM_BCL_PERIPHERAL_CTL=y
CONFIG_MSM_CAMCC_SDM845=y
CONFIG_MSM_CLK_AOP_QMP=y
CONFIG_MSM_CLK_RPMH=y
CONFIG_MSM_DEBUG_LAR_UNLOCK=y
CONFIG_MSM_DISPCC_SDM845=y
CONFIG_MSM_FASTCVPD=y
CONFIG_MSM_GCC_SDM845=y
CONFIG_MSM_GPUCC_SDM845=y
CONFIG_MSM_L2_SPM=y
CONFIG_MSM_PIL_MSS_QDSP6V5=y
CONFIG_MSM_QMP=y
CONFIG_MSM_QUSB_PHY=y
CONFIG_MSM_REMOTEQDSS=y
CONFIG_MSM_RPM_SMD=y
CONFIG_MSM_SNPS_FEMTO_PHY=y
CONFIG_MSM_SPCOM=y
CONFIG_MSM_SPM=y
CONFIG_MSM_SPSS_UTILS=y
CONFIG_MSM_VIDC_GOVERNORS=y
CONFIG_MSM_VIDC_V4L2=y
CONFIG_MSM_VIDEOCC_SDM845=y
CONFIG_NETFILTER_XT_MATCH_POLICY=y
CONFIG_NETLABEL=y
CONFIG_NEW_LEDS=y
CONFIG_NFC_PN547=y
CONFIG_NLS_ASCII=y
CONFIG_NLS_CODEPAGE_437=y
CONFIG_NLS_ISO8859_1=y
CONFIG_NLS_UTF8=y
CONFIG_PANIC_ON_DATA_CORRUPTION=y
CONFIG_PANIC_ON_RECURSIVE_FAULT=y
CONFIG_PCIEASPM_POWERSAVE=y
CONFIG_PCIE_DPC=y
CONFIG_PCIE_DW_PLAT=y
CONFIG_PCIEPORTBUS=y
CONFIG_PCIE_PTM=y
CONFIG_PCI=y
CONFIG_PHYLIB=y
CONFIG_PINCTRL_LPI=y
CONFIG_PINCTRL_SDM845=y
CONFIG_PON_SOMC_ORG=y
CONFIG_PSTORE_PMSG=y
CONFIG_PTP_1588_CLOCK=y
CONFIG_QCOM_BUS_CONFIG_RPMH=y
CONFIG_QCOM_CDSP_RM=y
CONFIG_QCOM_COINCELL=y
CONFIG_QCOM_COMMAND_DB=y
CONFIG_QCOM_DCC_V2=y
CONFIG_QCOM_GENI_SE=y
CONFIG_QCOM_GPI_DMA=y
CONFIG_QCOM_KRYO_L2_ACCESSORS=y
CONFIG_QCOM_LLCC=y
CONFIG_QCOM_QMI_DFC=y
CONFIG_QCOM_QMI_POWER_COLLAPSE=y
CONFIG_QCOM_QMI_RMNET=y
CONFIG_QCOM_RRADC=y
CONFIG_QCOM_SDM845_LLCC=y
CONFIG_QCOM_SMD_RPM=y
CONFIG_QCOM_SMSM=y
CONFIG_QCOM_SPMI_IADC=y
CONFIG_QCOM_SPMI_VADC=y
CONFIG_QCOM_SPS_DMA=y
CONFIG_QCOM_WDOG_IPI_ENABLE=y
CONFIG_QMP_DEBUGFS_CLIENT=y
CONFIG_QPNP_FG_GEN3=y
CONFIG_QPNP_MISC=y
CONFIG_QPNP_SMB2=y
CONFIG_QPNP_SMBFG_NEWGEN_EXTENSION=y
CONFIG_QSEE_IPC_IRQ_BRIDGE=y
CONFIG_QTI_AOP_REG_COOLING_DEVICE=y
CONFIG_QTI_RPMH_API=y
CONFIG_QTI_RPM_SMD_COOLING_DEVICE=y
CONFIG_QTI_THERMAL_LIMITS_DCVS=y
CONFIG_QTI_VIRTUAL_SENSOR=y
CONFIG_REGULATOR_FAN53555=y
CONFIG_REGULATOR_QPNP_LABIBB_SOMC=y
CONFIG_REGULATOR_QPNP_LABIBB=y
CONFIG_REGULATOR_QPNP_OLEDB=y
CONFIG_REGULATOR_QPNP=y
CONFIG_REGULATOR_REFGEN=y
CONFIG_REGULATOR_RPMH=y
CONFIG_REGULATOR_RPM_SMD=y
CONFIG_REMOTEPROC=y
CONFIG_RMNET_IPA3=y
CONFIG_RMNET_IPA=y
CONFIG_RMNET=y
CONFIG_RPMSG_QCOM_GLINK_RPM=y
CONFIG_RPMSG_QCOM_GLINK_SPSS=y
CONFIG_RPMSG_QCOM_SMD=y
CONFIG_SCSI_LOGGING=y
CONFIG_SCSI_UFSHCD_PLATFORM=y
CONFIG_SCSI_UFSHCD=y
CONFIG_SCSI_UFS_QCOM_ICE=y
CONFIG_SCSI_UFS_QCOM=y
CONFIG_SERIAL_MSM_GENI=y
CONFIG_SERIO_LIBPS2=y
CONFIG_SND_MAX_CARDS=32
CONFIG_SND_SOC_ANALOG_CDC=y
CONFIG_SND_SOC_DIGITAL_CDC=y
CONFIG_SND_SOC_INT_CODEC=y
CONFIG_SND_SOC_MSM_SDW=y
CONFIG_SND_SOC_SDM660_CDC=y
CONFIG_SND_SOC_SDM670=y
CONFIG_SND_SOC_SDM845=y
CONFIG_SND_USB_AUDIO_QMI=y
CONFIG_SOFTLOCKUP_DETECTOR=y
CONFIG_SOMC_RRADC_EXTENSION=y
CONFIG_SOUNDWIRE_WCD_CTRL=y
CONFIG_SPDM_SCM=y
CONFIG_SPECTRA_CAMERA=y
CONFIG_SPI_DEBUG=y
CONFIG_SPI_QCOM_GENI=y
CONFIG_SPI_QUP=y
CONFIG_SPMI_MSM_PMIC_ARB_DEBUG=y
CONFIG_STM=y
CONFIG_SW_SYNC=y
CONFIG_TOUCHSCREEN_CLEARPAD_I2C=y
CONFIG_TOUCHSCREEN_SYNAPTICS_DSX_TD_CORE=y
CONFIG_TOUCHSCREEN_SYNAPTICS_DSX_TD_RMI_DEV=y
CONFIG_TOUCHSCREEN_SYNAPTICS_DSX_TD=y
CONFIG_TOUCHSCREEN_SYNAPTICS_TCM=y
CONFIG_USB_ACM=y
CONFIG_USB_CC_FUSB301=y
CONFIG_USB_CI13XXX_MSM=y
CONFIG_USB_GADGET_DEBUG_FILES=y
CONFIG_USB_GADGET_DEBUG_FS=y
CONFIG_USB_GADGET_STORAGE_NUM_BUFFERS=4
CONFIG_USB_MON=y
CONFIG_USB_MSM_OTG_DOWNSTREAM=y
CONFIG_USB_MSM_SSPHY=y
CONFIG_USB_OTG_WAKELOCK=y
CONFIG_USB_SOMC_SLG4R41505=y
CONFIG_USB_STORAGE_ALAUDA=y
CONFIG_USB_STORAGE_CYPRESS_ATACB=y
CONFIG_USB_STORAGE_DATAFAB=y
CONFIG_USB_STORAGE_FREECOM=y
CONFIG_USB_STORAGE_ISD200=y
CONFIG_USB_STORAGE_JUMPSHOT=y
CONFIG_USB_STORAGE_KARMA=y
CONFIG_USB_STORAGE_SDDR09=y
CONFIG_USB_STORAGE_SDDR55=y
CONFIG_USB_STORAGE_USBAT=y
CONFIG_USB_TYPEC_MUX_NXP5150A=y
CONFIG_USB_ULPI=y
CONFIG_USB_VIDEO_CLASS=y
CONFIG_VIDEO_ADV_DEBUG=y
CONFIG_VIDEO_FIXED_MINOR_RANGES=y
```
